## apps/os_feature_tests/stack_canary/Kconfig
```kconfig
config BL_OS_FEATURE_TESTS_STACK_CANARY
	bool "Compiler stack canary test"
	default n
	depends on BUILD_FLAT && BUILTIN && STACK_CANARIES
	---help---
		Enable the deterministic compiler stack canary test.

if BL_OS_FEATURE_TESTS_STACK_CANARY

config BL_OS_FEATURE_TESTS_STACK_CANARY_PROGNAME
	string "Program name"
	default "stack_canary_test"

config BL_OS_FEATURE_TESTS_STACK_CANARY_PRIORITY
	int "Task priority"
	default 100

config BL_OS_FEATURE_TESTS_STACK_CANARY_STACKSIZE
	int "Stack size"
	default 2048

endif
```

## apps/os_feature_tests/syslog_coredump/Kconfig
```kconfig
config BL_OS_FEATURE_TESTS_SYSLOG_COREDUMP
	bool "Syslog coredump test"
	default n
	depends on BUILD_FLAT && BUILTIN
	depends on COREDUMP && BOARD_COREDUMP_SYSLOG
	depends on DEBUG_ASSERTIONS
	---help---
		Enable the controlled syslog coredump test.

if BL_OS_FEATURE_TESTS_SYSLOG_COREDUMP

config BL_OS_FEATURE_TESTS_SYSLOG_COREDUMP_PROGNAME
	string "Program name"
	default "syslog_coredump_test"

config BL_OS_FEATURE_TESTS_SYSLOG_COREDUMP_PRIORITY
	int "Task priority"
	default 100

config BL_OS_FEATURE_TESTS_SYSLOG_COREDUMP_STACKSIZE
	int "Task stack size"
	default 4096

endif
```

## apps/os_feature_tests/ubsan/Kconfig
```kconfig
config BL_OS_FEATURE_TESTS_UBSAN
	bool "Undefined behavior sanitizer test"
	default n
	depends on BUILD_FLAT && BUILTIN
	depends on MM_UBSAN && !MM_UBSAN_ALL
	depends on !MM_UBSAN_TRAP_ON_ERROR && !MM_UBSAN_DUMMY
	---help---
		Enable deterministic recover-mode UBSAN tests. The test target is
		instrumented for signed integer overflow and invalid shifts without
		enabling full-image instrumentation.

if BL_OS_FEATURE_TESTS_UBSAN

config BL_OS_FEATURE_TESTS_UBSAN_PRIORITY
	int "Task priority"
	default 100

config BL_OS_FEATURE_TESTS_UBSAN_STACKSIZE
	int "Stack size"
	default 2048

endif
```

## apps/perf_tools/perfmon/Kconfig
```kconfig
config BL_PERF_TOOLS_PERFMON
	tristate "BL616CL perfmon command"
	default n
	depends on BL616CL_PERFMON
	---help---
		NSH command that measures a time window: "perfmon stat" prints
		E907 counters (IPC, I-cache, D-cache and branch statistics) and
		the time spent in each interrupt; "perfmon prof" samples the PC
		on every tick and lists the hottest functions, or dumps the raw
		histogram for host tools with -r.  Start it in the background
		next to the workload, for example "perfmon stat -t 20 &" before
		iperf.

if BL_PERF_TOOLS_PERFMON

config BL_PERF_TOOLS_PERFMON_PROGNAME
	string "Program name"
	default "perfmon"

config BL_PERF_TOOLS_PERFMON_PRIORITY
	int "Task priority"
	default 100

config BL_PERF_TOOLS_PERFMON_STACKSIZE
	int "Stack size"
	default 4096

endif
```

## apps/wireless_tests/mible/Kconfig
```kconfig
config BL_WIRELESS_TESTS_MIBLE
	bool "zblue mible test command"
	default n
	depends on BT && BUILTIN
	select BT_MIBLE_TEST
	---help---
		Build mible_test.c of zblue, which the default zblue build leaves
		out, and the interactive command "mible" that runs its subcommands
		(init, broadcast, observer, peripheral, central, log_show ...).
		The zblue shell cannot reach them: its root command table does
		not list mible. Leave BT_SHELL off: the default zblue CMake fails
		to configure with it, and "mible" supplies the shell output
		functions mible_test.c needs.

# zblue's port/sections/defines.c adds the mible GATT service to its
# static service table only under this name, which zblue itself does
# not define.

config BT_MIBLE_TEST
	bool

if BL_WIRELESS_TESTS_MIBLE

config BL_WIRELESS_TESTS_MIBLE_PROGNAME
	string "Program name"
	default "mible"

config BL_WIRELESS_TESTS_MIBLE_PRIORITY
	int "Task priority"
	default 100

config BL_WIRELESS_TESTS_MIBLE_STACKSIZE
	int "Task stack size"
	default 4096

endif
```

## apps/wireless_tests/pmksa/Kconfig
```kconfig
config BL_WIRELESS_TESTS_PMKSA
	bool "Wi-Fi PMKSA ioctl test command"
	default n
	depends on NETDEV_WIRELESS_IOCTL && BUILTIN
	---help---
		Command "pmksa" that issues SIOCGIWPMKSA / SIOCSIWPMKSA with an
		explicit buffer length, and SIOCSIWENCODEEXT with any key length
		(wapi psk only takes 8 to 63 characters, so it cannot set a
		64-digit hex PSK).  Used by tools/bl616cl/pmksa_test.py.

if BL_WIRELESS_TESTS_PMKSA

config BL_WIRELESS_TESTS_PMKSA_PROGNAME
	string "Program name"
	default "pmksa"

config BL_WIRELESS_TESTS_PMKSA_PRIORITY
	int "Task priority"
	default 100

config BL_WIRELESS_TESTS_PMKSA_STACKSIZE
	int "Task stack size"
	default 2048

endif
```
