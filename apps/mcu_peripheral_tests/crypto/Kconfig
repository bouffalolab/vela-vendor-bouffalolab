## apps/mcu_peripheral_tests/crypto/Kconfig
```kconfig
menuconfig BL_MCU_PERIPHERAL_TESTS_CRYPTO
	bool "MCU peripheral crypto tests"
	default n
	depends on BL616CL_CRYPTO_AES
	depends on !DISABLE_PTHREAD
	depends on DEV_RANDOM
	---help---
		Enable the BL616CL SEC_ENG crypto case runner. It drives the AES
		modes and, with BL616CL_CRYPTO_SHA, the SHA algorithms through
		/dev/crypto and checks the results against reference checksums from
		crypto_vectors.py: all three CBC ids, the 128-bit CTR counter carry,
		XTS data units, SHA-224/384, streaming with COP_FLAG_UPDATE,
		interleaved AES and SHA sessions, in-place and unaligned buffers,
		zero and partial-block lengths, and messages larger than the bounce
		buffer.

if BL_MCU_PERIPHERAL_TESTS_CRYPTO

config BL_MCU_PERIPHERAL_TESTS_CRYPTO_PROGNAME
	string "Program name"
	default "mcu_crypto_test"

config BL_MCU_PERIPHERAL_TESTS_CRYPTO_PRIORITY
	int "Task priority"
	default 100

config BL_MCU_PERIPHERAL_TESTS_CRYPTO_STACKSIZE
	int "Stack size"
	default 4096

endif
```

## apps/mcu_peripheral_tests/dma/Kconfig
```kconfig
config BL_MCU_PERIPHERAL_TESTS_DMA
	tristate "MCU peripheral DMA tests"
	default n
	depends on BUILD_FLAT && BUILTIN
	depends on ARCH_CHIP_BL616CL && DMA && BL616CL_DMA0
	select BL616CL_DMA0_TEST
	---help---
		Enable the BL616CL DMA0 contract and hardware test runner. This is a
		test-only application and enables DMA adapter test hooks. Keep it
		disabled in product configurations.

if BL_MCU_PERIPHERAL_TESTS_DMA

config BL_MCU_PERIPHERAL_TESTS_DMA_PROGNAME
	string "Program name"
	default "mcu_dma_test"

config BL_MCU_PERIPHERAL_TESTS_DMA_PRIORITY
	int "Task priority"
	default 100

config BL_MCU_PERIPHERAL_TESTS_DMA_STACKSIZE
	int "Stack size"
	default 8192

endif
```

## apps/mcu_peripheral_tests/gpio/Kconfig
```kconfig
config BL_MCU_PERIPHERAL_TESTS_GPIO
	tristate "MCU peripheral GPIO tests"
	default n
	depends on DEV_GPIO && !DISABLE_SIGNALS
	---help---
		Enable the MCU peripheral GPIO case runner.

if BL_MCU_PERIPHERAL_TESTS_GPIO

config BL_MCU_PERIPHERAL_TESTS_GPIO_PROGNAME
	string "Program name"
	default "mcu_gpio_test"

config BL_MCU_PERIPHERAL_TESTS_GPIO_PRIORITY
	int "Task priority"
	default 100

config BL_MCU_PERIPHERAL_TESTS_GPIO_STACKSIZE
	int "Stack size"
	default DEFAULT_TASK_STACKSIZE

endif
```

## apps/mcu_peripheral_tests/i2c/Kconfig
```kconfig
config BL_MCU_PERIPHERAL_TESTS_I2C
	tristate "MCU peripheral I2C tests"
	default n
	depends on I2C && I2C_DRIVER && BL616CL_I2C
	depends on AI_M64L_KIT_I2C0 || AI_M64L_KIT_I2C1
	depends on !DISABLE_PTHREAD
	select BL616CL_I2C_TEST
	---help---
		Enable the BL616CL I2C master case runner. It exercises parameter
		validation, fake lower-half error paths, single-message transfers,
		combined write/read transfers, explicit target probes,
		EEPROM backup/restore, and
		per-bus concurrency. Hardware cases require an external I2C target.

if BL_MCU_PERIPHERAL_TESTS_I2C

config BL_MCU_PERIPHERAL_TESTS_I2C_PROGNAME
	string "Program name"
	default "mcu_i2c_test"

config BL_MCU_PERIPHERAL_TESTS_I2C_PRIORITY
	int "Task priority"
	default 100

config BL_MCU_PERIPHERAL_TESTS_I2C_STACKSIZE
	int "Stack size"
	default 6144

config BL_MCU_PERIPHERAL_TESTS_I2C_THREADS
	int "Concurrent transfer threads"
	default 4
	range 2 8

config BL_MCU_PERIPHERAL_TESTS_I2C_ITERATIONS
	int "Transfers per concurrent thread"
	default 32
	range 2 256

endif
```

## apps/mcu_peripheral_tests/i2s/Kconfig
```kconfig
menuconfig BL_MCU_PERIPHERAL_TESTS_I2S
	tristate "MCU peripheral I2S tests"
	default n
	depends on BL616CL_AVE_V10_AUDIO
	depends on !AUDIO_MULTI_SESSION
	---help---
		Play generated tones through /dev/audio/pcm0 and record from the
		board microphone through /dev/audio/pcm_in0, the two ES8388 codec
		devices on I2S0 of BL616CL-AVE-V10, with the audio ioctl interface.
		The tone, rate, restart and record cases check that every buffer
		comes back, the stream completes and the measured frame rate is
		within 2 % of the requested rate; a recording must also be free of
		isolated spikes. The other cases check empty FINAL buffers and that
		24 and 32-bit samples are rejected.
		Listen to the speaker to confirm the tone and the played-back
		recording.

if BL_MCU_PERIPHERAL_TESTS_I2S

config BL_MCU_PERIPHERAL_TESTS_I2S_PROGNAME
	string "Program name"
	default "mcu_i2s_test"

config BL_MCU_PERIPHERAL_TESTS_I2S_PRIORITY
	int "Task priority"
	default 100

config BL_MCU_PERIPHERAL_TESTS_I2S_STACKSIZE
	int "Stack size"
	default 4096

endif
```

## apps/mcu_peripheral_tests/psram/Kconfig
```kconfig
config BL_MCU_PERIPHERAL_TESTS_PSRAM
	bool "MCU peripheral PSRAM tests"
	default n
	depends on BL616CL_PSRAM && BL616CL_CACHE
	---help---
		Verify a large allocation from the PSRAM heap, address-dependent
		patterns and cache maintenance through the uncached alias.
		Only allocated memory is modified. Run manually on a test board.
```

## apps/mcu_peripheral_tests/pwm/Kconfig
```kconfig
menuconfig BL_MCU_PERIPHERAL_TESTS_PWM
	tristate "MCU peripheral PWM tests"
	default n
	depends on AI_M64P_KIT_PWM && BL616CL_PWM
	depends on !PWM_PULSECOUNT
	depends on !PWM_FREQUENCY_FIXED && !PWM_DEADTIME
	---help---
		Enable the BL616CL PWM test runner. It drives /dev/pwm0 through
		the standard PWM ioctls and checks their results. With a GPIO
		input wired to the primary channel output (-g) it also checks the
		idle level after STOP. Waveform frequency and duty are measured
		with a logic analyzer.

if BL_MCU_PERIPHERAL_TESTS_PWM

config BL_MCU_PERIPHERAL_TESTS_PWM_PROGNAME
	string "Program name"
	default "mcu_pwm_test"

config BL_MCU_PERIPHERAL_TESTS_PWM_PRIORITY
	int "Task priority"
	default 100

config BL_MCU_PERIPHERAL_TESTS_PWM_STACKSIZE
	int "Stack size"
	default 6144

endif
```

## apps/mcu_peripheral_tests/rtc/Kconfig
```kconfig
config BL_MCU_PERIPHERAL_TESTS_RTC
	bool "MCU peripheral RTC tests"
	default n
	depends on BL616CL_RTC
	depends on !BL616CL_RTC_ALARM || !DISABLE_SIGNALS
	---help---
			Enable the built-in MCU peripheral RTC case runner. Alarm cases are
			reported as unavailable when BL616CL_RTC_ALARM is not enabled.

if BL_MCU_PERIPHERAL_TESTS_RTC

config BL_MCU_PERIPHERAL_TESTS_RTC_PROGNAME
	string "Program name"
	default "mcu_rtc_test"

config BL_MCU_PERIPHERAL_TESTS_RTC_PRIORITY
	int "Task priority"
	default 100

config BL_MCU_PERIPHERAL_TESTS_RTC_STACKSIZE
	int "Stack size"
	default 4096

endif
```

## apps/mcu_peripheral_tests/spi/Kconfig
```kconfig
config BL_MCU_PERIPHERAL_TESTS_SPI
	tristate "MCU peripheral SPI tests"
	default n
	depends on SPI && SPI_EXCHANGE && BL616CL_SPI
	depends on BL616CL_SPI0 || BL616CL_SPI1
	depends on !DISABLE_PTHREAD
	select BL616CL_SPI_TEST
	select SPI_BITORDER
	---help---
		Enable the BL616CL SPI master case runner. It exercises fake
		configuration, timeout recovery, length boundaries, and concurrency.
		Hardware loopback additionally requires the board /dev/spi0 node.

if BL_MCU_PERIPHERAL_TESTS_SPI

config BL_MCU_PERIPHERAL_TESTS_SPI_PROGNAME
	string "Program name"
	default "mcu_spi_test"

config BL_MCU_PERIPHERAL_TESTS_SPI_PRIORITY
	int "Task priority"
	default 100

config BL_MCU_PERIPHERAL_TESTS_SPI_STACKSIZE
	int "Stack size"
	default 6144

config BL_MCU_PERIPHERAL_TESTS_SPI_ITERATIONS
	int "Concurrent transfer iterations"
	default 32
	range 2 256

endif
```

## apps/mcu_peripheral_tests/timer/Kconfig
```kconfig
config BL_MCU_PERIPHERAL_TESTS_TIMER
	tristate "MCU peripheral timer tests"
	default n
	depends on TIMER && !DISABLE_SIGNALS
	---help---
		Enable the MCU peripheral TIMER case runner.

if BL_MCU_PERIPHERAL_TESTS_TIMER

config BL_MCU_PERIPHERAL_TESTS_TIMER_PROGNAME
	string "Program name"
	default "mcu_timer_test"

config BL_MCU_PERIPHERAL_TESTS_TIMER_PRIORITY
	int "Task priority"
	default 100

config BL_MCU_PERIPHERAL_TESTS_TIMER_STACKSIZE
	int "Stack size"
	default DEFAULT_TASK_STACKSIZE

endif
```

## apps/mcu_peripheral_tests/trng/Kconfig
```kconfig
config BL_MCU_PERIPHERAL_TESTS_TRNG
	bool "MCU peripheral TRNG tests"
	default n
	depends on BL616CL_TRNG && (DEV_RANDOM || DEV_URANDOM_ARCH)
	depends on !DISABLE_PTHREAD
	---help---
		Enable the BL616CL TRNG case runner. It covers the standard random
		device ABI, boundary lengths, unaligned buffers, basic data smoke
		checks, poll behavior, unsupported ioctl handling, and concurrent
		readers. The checks do not certify entropy quality.

if BL_MCU_PERIPHERAL_TESTS_TRNG

config BL_MCU_PERIPHERAL_TESTS_TRNG_PROGNAME
	string "Program name"
	default "mcu_trng_test"

config BL_MCU_PERIPHERAL_TESTS_TRNG_PRIORITY
	int "Task priority"
	default 100

config BL_MCU_PERIPHERAL_TESTS_TRNG_STACKSIZE
	int "Stack size"
	default 4096

config BL_MCU_PERIPHERAL_TESTS_TRNG_THREADS
	int "Concurrent reader threads"
	default 4
	range 2 8

config BL_MCU_PERIPHERAL_TESTS_TRNG_ITERATIONS
	int "Reads per concurrent reader"
	default 32
	range 4 256

endif
```

## apps/mcu_peripheral_tests/uart/Kconfig
```kconfig
config BL_MCU_PERIPHERAL_TESTS_UART
	tristate "MCU peripheral UART tests"
	default n
	depends on SERIAL && SERIAL_TERMIOS && BL616CL_UART1
	depends on !DISABLE_PTHREAD
	---help---
		Enable the BL616CL UART1 standard-serial case runner.  UART1 is
			opened as /dev/ttyS1 and requires an external loopback from GPIO14
			(TX) to GPIO15 (RX) for the data cases.

if BL_MCU_PERIPHERAL_TESTS_UART

config BL_MCU_PERIPHERAL_TESTS_UART_PROGNAME
	string "Program name"
	default "mcu_uart_test"

config BL_MCU_PERIPHERAL_TESTS_UART_PRIORITY
	int "Task priority"
	default 100

config BL_MCU_PERIPHERAL_TESTS_UART_STACKSIZE
	int "Stack size"
	default 8192

endif
```

## apps/mcu_peripheral_tests/wdt/Kconfig
```kconfig
config BL_MCU_PERIPHERAL_TESTS_WDT
	tristate "MCU peripheral WDT tests"
	default n
	depends on WATCHDOG && BOARDCTL_RESET_CAUSE
	---help---
		Enable the MCU peripheral WDT case runner.

if BL_MCU_PERIPHERAL_TESTS_WDT

config BL_MCU_PERIPHERAL_TESTS_WDT_PROGNAME
	string "Program name"
	default "mcu_wdt_test"

config BL_MCU_PERIPHERAL_TESTS_WDT_PRIORITY
	int "Task priority"
	default 100

config BL_MCU_PERIPHERAL_TESTS_WDT_STACKSIZE
	int "Stack size"
	default DEFAULT_TASK_STACKSIZE

endif
```

## apps/os_feature_tests/cache/Kconfig
```kconfig
config BL_OS_FEATURE_TESTS_CACHE
	bool "BL616CL cache contract test"
	default n
	depends on BUILD_FLAT && BUILTIN
	depends on ARCH_CHIP_BL616CL && BL616CL_CACHE
	---help---
		Enable BL616CL cache API hardware behavior tests. Cache maintenance
		calls use only the public API; all test support stays outside the chip
		adapter.

if BL_OS_FEATURE_TESTS_CACHE

config BL_OS_FEATURE_TESTS_CACHE_PRIORITY
	int "Task priority"
	range 2 255
	default 100

config BL_OS_FEATURE_TESTS_CACHE_STACKSIZE
	int "Task stack size"
	default 4096

endif
```

## apps/os_feature_tests/lazy_fpu/Kconfig
```kconfig
config BL_OS_FEATURE_TESTS_LAZY_FPU
	bool "RISC-V FPU context test"
	default n
	depends on ARCH_RISCV && ARCH_RV32 && ARCH_FPU
	depends on !ARCH_DPFPU && !ARCH_QPFPU
	depends on !DISABLE_PTHREAD && !DISABLE_SIGNALS
	depends on !DISABLE_POSIX_TIMERS
	depends on BUILD_FLAT && BUILTIN
	---help---
		Enable a two-thread FPU context isolation test. Each worker keeps
		distinct values in the RISC-V callee-saved floating-point registers
		across scheduler and timer interrupt activity.

if BL_OS_FEATURE_TESTS_LAZY_FPU

config BL_OS_FEATURE_TESTS_LAZY_FPU_PRIORITY
	int "Task priority"
	range 2 255
	default 100

config BL_OS_FEATURE_TESTS_LAZY_FPU_STACKSIZE
	int "Main task stack size"
	default 3072

config BL_OS_FEATURE_TESTS_LAZY_FPU_WORKER_STACKSIZE
	int "Worker stack size"
	default 2048

config BL_OS_FEATURE_TESTS_LAZY_FPU_ITERATIONS
	int "Context switch iterations"
	range 1 10000
	default 200

config BL_OS_FEATURE_TESTS_LAZY_FPU_SLEEP_US
	int "Worker sleep interval in microseconds"
	range 1 1000000
	default 1000

endif
```

## apps/os_feature_tests/mm_record/Kconfig
```kconfig
config BL_OS_FEATURE_TESTS_MM_RECORD
	bool "Heap allocation record test"
	default n
	depends on BUILD_FLAT && BUILTIN && !DISABLE_PTHREAD
	depends on MM_RECORD_PID && MM_RECORD_SEQNO
	---help---
		Enable the deterministic heap allocation record test.

if BL_OS_FEATURE_TESTS_MM_RECORD

config BL_OS_FEATURE_TESTS_MM_RECORD_PROGNAME
	string "Program name"
	default "mm_record_test"

config BL_OS_FEATURE_TESTS_MM_RECORD_PRIORITY
	int "Task priority"
	default 100

config BL_OS_FEATURE_TESTS_MM_RECORD_STACKSIZE
	int "Stack size"
	default 4096 if BL_OS_FEATURE_TESTS_MM_RECORD_REALLOC_STACK
	default 2048

config BL_OS_FEATURE_TESTS_MM_RECORD_WORKER_STACKSIZE
	int "Worker thread stack size"
	default PTHREAD_STACK_DEFAULT

config BL_OS_FEATURE_TESTS_MM_RECORD_REALLOC_STACK
	bool "Default allocator realloc stack test"
	default n
	depends on MM_DEFAULT_MANAGER && MM_RECORD_STACK && FS_PROCFS
	depends on !FS_PROCFS_EXCLUDE_MEMINFO
	---help---
		Enable deterministic private-heap tests for realloc stack record
		ownership. This option uses NuttX default allocator internals only in
		the test application.

config BL_OS_FEATURE_TESTS_MM_RECORD_STACK
	bool "Heap backtrace contract test"
	default n
	depends on MM_DEFAULT_MANAGER && MM_RECORD_STACK
	depends on FS_PROCFS && !FS_PROCFS_EXCLUDE_MEMINFO
	depends on !FS_PROCFS_EXCLUDE_MEMDUMP
	depends on BL_OS_FEATURE_TESTS_MM_RECORD
	depends on BL_OS_FEATURE_TESTS_MM_RECORD_REALLOC_STACK
	---help---
		Enable the M02 heap backtrace gate, filter, pool and KASAN tests.
		The test uses one application main and a test-only private heap.

endif
```

## apps/os_feature_tests/noteram/Kconfig
```kconfig
config BL_OS_FEATURE_TESTS_NOTERAM
	bool "Note RAM trace test"
	default n
	depends on BUILD_FLAT && BUILTIN
	depends on DRIVERS_NOTERAM
	---help---
		Enable the Note RAM status, clear, mode and burst test.

if BL_OS_FEATURE_TESTS_NOTERAM

config BL_OS_FEATURE_TESTS_NOTERAM_PROGNAME
	string "Program name"
	default "noteram_test"

config BL_OS_FEATURE_TESTS_NOTERAM_PRIORITY
	int "Task priority"
	default 100

config BL_OS_FEATURE_TESTS_NOTERAM_STACKSIZE
	int "Task stack size"
	default 2048

endif
```

## apps/os_feature_tests/prio_inherit/Kconfig
```kconfig
config BL_OS_FEATURE_TESTS_PRIO_INHERIT
	bool "Mutex priority inheritance test"
	default n
	depends on BUILD_FLAT && BUILTIN
	depends on PRIORITY_INHERITANCE && !DISABLE_PTHREAD
	---help---
		Enable the mutex priority inheritance test: a low priority owner,
		a busy middle priority thread and a high priority waiter, for the
		default pthread mutex, a PTHREAD_PRIO_NONE mutex (control case)
		and a kernel nxmutex, plus two held mutexes and a timed out
		waiter.

if BL_OS_FEATURE_TESTS_PRIO_INHERIT

config BL_OS_FEATURE_TESTS_PRIO_INHERIT_PROGNAME
	string "Program name"
	default "prio_inherit_test"

config BL_OS_FEATURE_TESTS_PRIO_INHERIT_PRIORITY
	int "Task priority"
	default 100

config BL_OS_FEATURE_TESTS_PRIO_INHERIT_STACKSIZE
	int "Task stack size"
	default 4096

endif
```

## apps/os_feature_tests/rtc_ioctl/Kconfig
```kconfig
config BL_OS_FEATURE_TESTS_RTC_IOCTL
	bool "RTC upper-half ioctl validation test"
	default n
	depends on BUILD_FLAT && BUILTIN
	depends on RTC_DRIVER && !DISABLE_PSEUDOFS_OPERATIONS
	---help---
		Enable a fake RTC lower-half and a built-in test application for
		validating the common RTC upper-half ioctl argument contract. The
		fake device is registered only while the test application runs.

if BL_OS_FEATURE_TESTS_RTC_IOCTL

config BL_OS_FEATURE_TESTS_RTC_IOCTL_PROGNAME
	string "Program name"
	default "rtc_ioctl_test"

config BL_OS_FEATURE_TESTS_RTC_IOCTL_PRIORITY
	int "Task priority"
	default 100

config BL_OS_FEATURE_TESTS_RTC_IOCTL_STACKSIZE
	int "Stack size"
	default 4096

endif
```
