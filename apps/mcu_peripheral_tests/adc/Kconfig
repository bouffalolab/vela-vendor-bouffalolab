## chips/bl618dg/Kconfig
```kconfig
#
# For a description of the syntax of this configuration file,
# see the file kconfig-language.txt in the NuttX tools repository.
#

if ARCH_CHIP_CUSTOM

comment "BouffaloLab BL618DG Configuration Options"

choice
	prompt "BouffaloLab Chip Selection"
	default ARCH_CHIP_BL618DG

config ARCH_CHIP_BL618DG
	bool "BL618DG"
	select ARCH_RV32
	select ARCH_HAVE_FPU
	select ARCH_HAVE_DPFPU
	select ARCH_HAVE_RESET
	select ARCH_RV_ISA_M
	select ARCH_RV_ISA_A
	select ARCH_RV_ISA_C
	select ARCH_RV_ISA_ZICSR_ZIFENCEI
	select ONESHOT
	select ONESHOT_COUNT
	select ONESHOT_FAST_DIVISION
	select ALARM_ARCH
	---help---
		BouffaloLab BL618DG Nuclei AP platform.

endchoice

menu "BL618DG Peripheral Support"

config BL618DG_CACHE
	bool "OpenVela cache maintenance API"
	default y
	select ARCH_ICACHE
	select ARCH_DCACHE
	---help---
		Expose the BL618DG instruction and data cache through the complete
		OpenVela cache API. I-cache and D-cache are selected together because
		the coherent-cache ABI requires both implementations. The boot path
		continues to enable hardware caches when this option is disabled.

menuconfig BL618DG_UART
	bool "UART"
	default y
	select ARCH_HAVE_SERIAL_TERMIOS
	---help---
		Enable the BL618DG UART serial drivers.

if BL618DG_UART

menuconfig BL618DG_UART0
	bool "UART0"
	default y
	select UART0_SERIALDRIVER
	---help---
		Enable UART0, used as the serial console on the supported boards.

if BL618DG_UART0

config BL618DG_UART0_RXPIN
	int "UART0 RX pin"
	range 0 52
	default 12
	---help---
		GPIO number routed to the UART0 RX signal.

config BL618DG_UART0_TXPIN
	int "UART0 TX pin"
	range 0 52
	default 11
	---help---
		GPIO number routed to the UART0 TX signal.

endif # BL618DG_UART0

endif # BL618DG_UART

endmenu

endif # ARCH_CHIP_CUSTOM
```

## components/display/Kconfig
```kconfig
# SPDX-License-Identifier: Apache-2.0
#
# No menu: component symbols have no prompt. BL_COMPONENT_DISPLAY is
# selected by BL616CL_DISPLAY, each panel description by the board option
# of the panel module that uses it.

config BL_COMPONENT_DISPLAY
	bool
	depends on ARCH_CHIP_BL616CL
	help
	  Selected by BL616CL_DISPLAY. Builds the display framework of the
	  Bouffalo SDK (display, bus and panel cores, the generic DCS panel
	  driver, the standard RGB panels, the scanout core and the simple
	  font) with its NuttX platform layer and, with LCD, the NuttX LCD
	  device glue.

if BL_COMPONENT_DISPLAY

config BL_COMPONENT_DISPLAY_PANEL_ST7789
	bool

config BL_COMPONENT_DISPLAY_PANEL_ST7796
	bool

config BL_COMPONENT_DISPLAY_PANEL_ILI9341
	bool

config BL_COMPONENT_DISPLAY_PANEL_ILI9488
	bool

config BL_COMPONENT_DISPLAY_PANEL_GC9A01
	bool

config BL_COMPONENT_DISPLAY_PANEL_GC9307
	bool

config BL_COMPONENT_DISPLAY_PANEL_ILI9486
	bool

config BL_COMPONENT_DISPLAY_PANEL_JD9853
	bool

config BL_COMPONENT_DISPLAY_PANEL_ST7735
	bool

config BL_COMPONENT_DISPLAY_PANEL_ST77922
	bool

config BL_COMPONENT_DISPLAY_PANEL_SPD2010
	bool

config BL_COMPONENT_DISPLAY_PANEL_NT35510
	bool

config BL_COMPONENT_DISPLAY_PANEL_ST7701S
	bool

config BL_COMPONENT_DISPLAY_PANEL_ST7701P
	bool

config BL_COMPONENT_DISPLAY_PANEL_GC9503V
	bool

config BL_COMPONENT_DISPLAY_PANEL_JD9165BA
	bool

config BL_COMPONENT_DISPLAY_PANEL_EK79007
	bool

config BL_COMPONENT_DISPLAY_PANEL_AXS15231B
	bool

config BL_COMPONENT_DISPLAY_PANEL_AXS15231E
	bool

config BL_COMPONENT_DISPLAY_PANEL_FL7707N
	bool

config BL_COMPONENT_DISPLAY_PANEL_ILI9806E
	bool

config BL_COMPONENT_DISPLAY_PANEL_ILI9881C
	bool

config BL_COMPONENT_DISPLAY_PANEL_JD9365TX
	bool

config BL_COMPONENT_DISPLAY_PANEL_ST7102
	bool

endif # BL_COMPONENT_DISPLAY

rsource "touch/Kconfig"
```
