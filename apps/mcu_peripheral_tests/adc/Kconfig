## apps/mcu_peripheral_tests/adc/Kconfig
```kconfig
menuconfig BL_MCU_PERIPHERAL_TESTS_ADC
	tristate "MCU peripheral ADC tests"
	default n
	depends on AI_M64P_KIT_ADC && BL616CL_ADC
	depends on !DISABLE_PTHREAD
	---help---
		Enable the BL616CL GPADC test runner. It reads /dev/adc0 through
		read(), poll() and the standard ANIOC ioctls and checks the
		channel order, the sample count, the error codes of the selected
		transfer mode and the queue lifetime. The accuracy case needs a
		known voltage on the channel inputs.

if BL_MCU_PERIPHERAL_TESTS_ADC

config BL_MCU_PERIPHERAL_TESTS_ADC_PROGNAME
	string "Program name"
	default "mcu_adc_test"

config BL_MCU_PERIPHERAL_TESTS_ADC_PRIORITY
	int "Task priority"
	default 100

config BL_MCU_PERIPHERAL_TESTS_ADC_STACKSIZE
	int "Stack size"
	default 6144

endif
```

## apps/mcu_peripheral_tests/display/Kconfig
```kconfig
menuconfig BL_MCU_PERIPHERAL_TESTS_DISPLAY
	tristate "MCU peripheral display tests"
	default n
	depends on BL616CL_AVE_V10_DISPLAY && LCD_DEV
	depends on !DISABLE_PTHREAD
	---help---
		Draw test patterns on /dev/lcd0, the U10 panel of BL616CL-AVE-V10,
		through the LCD character device ioctls: color bars with corner
		markers, full-screen fills with the frame rate, and small,
		odd-sized and non-contiguous areas. The ioctls must succeed; the
		picture is checked by eye. With a touchscreen on /dev/input0, a
		person taps five targets and drags across the panel, and an idle
		case checks that no touch is reported while nobody touches it.

if BL_MCU_PERIPHERAL_TESTS_DISPLAY

config BL_MCU_PERIPHERAL_TESTS_DISPLAY_PROGNAME
	string "Program name"
	default "mcu_display_test"

config BL_MCU_PERIPHERAL_TESTS_DISPLAY_PRIORITY
	int "Task priority"
	default 100

config BL_MCU_PERIPHERAL_TESTS_DISPLAY_STACKSIZE
	int "Stack size"
	default 4096

endif
```

## boards/bl616cl/bl616cl-ave-v10/Kconfig
```kconfig
#
# For a description of the syntax of this configuration file,
# see the file kconfig-language.txt in the NuttX tools repository.
#

config ARCH_BOARD_BL616CL_AVE_V10
	def_bool y
	---help---
		Board identity, defined only while this board is selected. Test
		apps that need this board's wiring depend on it.

config BL616CL_AVE_V10_I2C0
	bool "BL616CL-AVE-V10 I2C0 (ES8388, camera SCCB)"
	default n
	select BL616CL_I2C
	select BL616CL_I2C0
	---help---
		Register I2C0 as /dev/i2c0 on GPIO20 (SCL) and GPIO11 (SDA). The
		board wires the ES8388 codec (address 0x10) and the camera
		connector SCCB to this bus with 4.7 kOhm pull-ups to 3.3 V.

menuconfig BL616CL_AVE_V10_AUDIO
	bool "BL616CL-AVE-V10 ES8388 audio (/dev/audio/pcm0, pcm_in0)"
	default n
	depends on AUDIO_ES8388 && BL616CL_DMA0
	select BL616CL_AVE_V10_I2C0
	select BL616CL_I2S
	---help---
		Register the ES8388 codec (I2C0 address 0x10, I2S0 with MCLK on
		GPIO1, BCLK 4, FS 5, DI 6, DO 7) as /dev/audio/pcm0 for playback and
		/dev/audio/pcm_in0 for recording; use one at a time.

		The speaker amplifier takes ROUT1 and ROUT2 as a differential pair,
		the on-board microphone is on LIN2, and the speaker lines come back
		attenuated to LIN1 and RIN1. The ES8388 output and input channel
		options select the codec path; this menu shows what the current
		choice gives on this board. The board README lists every choice.

if BL616CL_AVE_V10_AUDIO

comment "Speaker: ES8388 output Line 2 drives it from ROUT2"
	depends on ES8388_OUTPUT_CHANNEL_LINE2

comment "Speaker: ES8388 output Line 1 drives it from ROUT1 (untested)"
	depends on ES8388_OUTPUT_CHANNEL_LINE1

comment "Speaker: nearly silent, output Both cancels at the amplifier"
	depends on ES8388_OUTPUT_CHANNEL_ALL

comment "Recording: ES8388 input Line 2 is the on-board microphone"
	depends on ES8388_INPUT_CHANNEL_LINE2

comment "Recording: ES8388 input Line 1 is the speaker feedback (untested)"
	depends on ES8388_INPUT_CHANNEL_LINE1

comment "Recording: input Differential is the speaker feedback (untested)"
	depends on ES8388_INPUT_CHANNEL_DIFFERENTIAL

endif # BL616CL_AVE_V10_AUDIO

menuconfig BL616CL_AVE_V10_DISPLAY
	bool "BL616CL-AVE-V10 U10 8080 panel (/dev/lcd0)"
	default n
	depends on BL616CL_DISPLAY && BL616CL_DBI
	select LCD
	---help---
		Drive the panel on connector U10 through the DBI controller as
		MIPI DBI type B (8080, 8 data lines): CS GPIO0 (software), WR
		GPIO2, DC GPIO36, D0..D7 GPIO12..19. RD, reset, TE and backlight
		are not wired, so the panel cannot be identified: pick its module
		below. The panel is registered as /dev/lcd0 with LCD_DEV and as
		/dev/fb0 with VIDEO_FB and LCD_FRAMEBUFFER. GPIO36 is also BOOT,
		which the USB-UART DTR drives.

if BL616CL_AVE_V10_DISPLAY

choice
	prompt "Panel module"
	default BL616CL_AVE_V10_DISPLAY_ST7796_320X480

config BL616CL_AVE_V10_DISPLAY_ST7796_320X480
	bool "ST7796 320x480"
	select BL_COMPONENT_DISPLAY_PANEL_ST7796

config BL616CL_AVE_V10_DISPLAY_ILI9488_320X480
	bool "ILI9488 320x480"
	select BL_COMPONENT_DISPLAY_PANEL_ILI9488

config BL616CL_AVE_V10_DISPLAY_ILI9486_320X480
	bool "ILI9486 320x480"
	select BL_COMPONENT_DISPLAY_PANEL_ILI9486

config BL616CL_AVE_V10_DISPLAY_ST77922_320X480
	bool "ST77922 320x480"
	select BL_COMPONENT_DISPLAY_PANEL_ST77922

config BL616CL_AVE_V10_DISPLAY_ST7789_240X320
	bool "ST7789 240x320"
	select BL_COMPONENT_DISPLAY_PANEL_ST7789

config BL616CL_AVE_V10_DISPLAY_ILI9341_240X320
	bool "ILI9341 240x320"
	select BL_COMPONENT_DISPLAY_PANEL_ILI9341

config BL616CL_AVE_V10_DISPLAY_GC9307_240X320
	bool "GC9307 240x320"
	select BL_COMPONENT_DISPLAY_PANEL_GC9307

config BL616CL_AVE_V10_DISPLAY_JD9853_240X320
	bool "JD9853 240x320"
	select BL_COMPONENT_DISPLAY_PANEL_JD9853

config BL616CL_AVE_V10_DISPLAY_NT35510_480X800
	bool "NT35510 480x800"
	select BL_COMPONENT_DISPLAY_PANEL_NT35510

endchoice

config BL616CL_AVE_V10_DISPLAY_FREQ
	int "WR clock in Hz (0: 27 MHz)"
	default 0
	---help---
		Write clock of the 8080 interface. 0 takes the interface default
		of 27 MHz. The DBI controller divides 160 MHz by a whole number,
		so the clock is the nearest such value, at most 54 MHz.

choice
	prompt "Rotation"
	default BL616CL_AVE_V10_DISPLAY_ROTATION_0

config BL616CL_AVE_V10_DISPLAY_ROTATION_0
	bool "0 degrees"

config BL616CL_AVE_V10_DISPLAY_ROTATION_90
	bool "90 degrees"

config BL616CL_AVE_V10_DISPLAY_ROTATION_180
	bool "180 degrees"

config BL616CL_AVE_V10_DISPLAY_ROTATION_270
	bool "270 degrees"

endchoice

endif # BL616CL_AVE_V10_DISPLAY

menuconfig BL616CL_AVE_V10_TOUCH
	bool "BL616CL-AVE-V10 U10 touch panel (/dev/input0)"
	default n
	depends on BL616CL_TOUCH
	select BL616CL_AVE_V10_I2C0
	---help---
		Register the touch controller of the U10 panel, on I2C0 (U10 pin 5
		SCL, pin 8 SDA), as /dev/input0. U10 wires no interrupt or reset
		line, so the controller is polled and must answer at its default
		address: the panel shipped with the board has a GT911 at 0x5d.

if BL616CL_AVE_V10_TOUCH

choice
	prompt "Touch controller"
	default BL616CL_AVE_V10_TOUCH_GT911

config BL616CL_AVE_V10_TOUCH_GT911
	bool "GT911 (0x5d)"
	select BL_COMPONENT_TOUCH_GT911

config BL616CL_AVE_V10_TOUCH_FT6X36
	bool "FT6x36 (0x38)"
	select BL_COMPONENT_TOUCH_FT6X36

endchoice

config BL616CL_AVE_V10_TOUCH_PERIOD
	int "Poll period (ms)"
	default 20
	range 5 1000
	---help---
		Interval between two reads of the touch point.

endif # BL616CL_AVE_V10_TOUCH
```

## boards/bl618dg/bl618dgdk/Kconfig
```kconfig
#

config ARCH_BOARD_BL618DGDK
	def_bool y
	---help---
		BouffaloLab BL618DGDK board.
```

## boards/bl618dg/bl618dgdk/configs/compile/defconfig
```kconfig
CONFIG_ALLOW_BSD_COMPONENTS=y
CONFIG_ARCH="risc-v"
CONFIG_ARCH_BOARD_CUSTOM=y
CONFIG_ARCH_BOARD_CUSTOM_DIR="../vendor/bouffalolab/boards/bl618dg/bl618dgdk"
CONFIG_ARCH_BOARD_CUSTOM_DIR_RELPATH=y
CONFIG_ARCH_BOARD_CUSTOM_NAME="bl618dgdk"
CONFIG_ARCH_CHIP_CUSTOM=y
CONFIG_ARCH_CHIP_CUSTOM_DIR="../vendor/bouffalolab/chips/bl618dg"
CONFIG_ARCH_CHIP_CUSTOM_DIR_RELPATH=y
CONFIG_ARCH_CHIP_CUSTOM_NAME="bl618dg"
CONFIG_ARCH_CHIP_RISCV_CUSTOM=y
CONFIG_ARCH_DPFPU=y
CONFIG_ARCH_FPU=y
CONFIG_ARCH_INTERRUPTSTACK=2048
# CONFIG_ARCH_LOWPUTC is not set
CONFIG_ARCH_RISCV=y
CONFIG_DEBUG_FEATURES=y
CONFIG_DEBUG_FULLOPT=y
CONFIG_DEBUG_SYMBOLS=y
CONFIG_EXAMPLES_HELLO=y
CONFIG_INIT_ENTRYPOINT="hello_main"
CONFIG_RAM_START=0xa1001800
CONFIG_RAM_SIZE=452608
CONFIG_RAW_BINARY=y
CONFIG_RAMLOG=y
CONFIG_RAMLOG_SYSLOG=y
CONFIG_CONSOLE_SYSLOG=y
# CONFIG_SERIAL is not set
CONFIG_USEC_PER_TICK=1000
```
