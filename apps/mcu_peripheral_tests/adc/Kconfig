## chips/bl616cl/Kconfig
```kconfig
#
# For a description of the syntax of this configuration file,
# see the file kconfig-language.txt in the NuttX tools repository.
#

if ARCH_CHIP_CUSTOM

comment "BouffaloLab BL616CL Configuration Options"

choice
	prompt "BouffaloLab Chip Selection"
	default ARCH_CHIP_BL616CL

config ARCH_CHIP_BL616CL
	bool "BL616CL"
	select ARCH_RV32
	select ARCH_HAVE_FPU
	select ARCH_HAVE_MISALIGN_EXCEPTION
	select ARCH_HAVE_RESET
	select ARCH_HAVE_NETDEV_STATISTICS
	select ARCH_HAVE_PWM_MULTICHAN
	select ARCH_RV_ISA_M
	select ARCH_RV_ISA_A
	select ARCH_RV_ISA_C
	select ARCH_RV_ISA_ZICSR_ZIFENCEI
	select ONESHOT
	select ONESHOT_COUNT
	select ONESHOT_FAST_DIVISION
	select ALARM_ARCH
	---help---
		BouffaloLab BL616CL E907 platform.

endchoice

menu "BL616CL Memory Layout"

choice
	prompt "BLE exchange memory (EM)"
	default BL616CL_EM_NONE
	---help---
		EM is carved from the top of WRAM for the BLE controller. The boot
		code programs GLB EM_SEL to match. The linker script places .wifibss
		(macsw shared data, wl80211 RX buffers and the IOB pool) right below
		EM and gives the RAM below it to the heap, so EM comes out of the
		heap. The CMake build does not regenerate the linker script when
		only the configuration changes, so run "vela clean" after changing
		this.

config BL616CL_EM_NONE
	bool "None"

config BL616CL_EM_16K
	bool "16 KiB"

config BL616CL_EM_32K
	bool "32 KiB"

endchoice

config BL616CL_EM_SIZE
	int
	default 32 if BL616CL_EM_32K
	default 16 if BL616CL_EM_16K
	default 0

endmenu

menu "BL616CL Peripheral Support"

config BL616CL_CACHE
	bool "OpenVela cache maintenance API"
	default y
	select ARCH_ICACHE
	select ARCH_DCACHE
	---help---
		Expose the BL616CL instruction and data cache through the complete
		OpenVela cache API. I-cache and D-cache are selected together because
		the coherent-cache ABI requires both implementations. The boot path
		continues to enable hardware caches when this option is disabled.

config BL616CL_PSRAM
	bool "Winbond x8 PSRAM heap"
	default n
	depends on BUILD_FLAT && !MM_SMALL && MM_REGIONS >= 2
	depends on !PMP_NO_INIT
	select BL616CL_CACHE
	---help---
		Initialize Winbond x8 PSRAM and add its detected
		4, 8 or 16 MiB capacity to the default heap. Initialization failures
		are reported on the early console and leave PSRAM out of the heap.
		Without factory trim, calibrate DQS using the first 4 MiB before
		heap registration. Corrupt factory trim and 32 MiB devices are not
		supported. This option does not place static sections in PSRAM.

menuconfig BL616CL_UART
	bool "UART"
	default y
	select ARCH_HAVE_SERIAL_TERMIOS
	---help---
		Enable the BL616CL UART serial drivers.

if BL616CL_UART

menuconfig BL616CL_UART0
	bool "UART0"
	default y
	select UART0_SERIALDRIVER
	---help---
		Enable UART0, used as the serial console on the supported boards.

if BL616CL_UART0

config BL616CL_UART0_RXPIN
	int "UART0 RX pin"
	range 0 36
	default 35
	---help---
		GPIO number routed to the UART0 RX signal.

config BL616CL_UART0_TXPIN
	int "UART0 TX pin"
	range 0 36
	default 34
	---help---
		GPIO number routed to the UART0 TX signal.

endif # BL616CL_UART0

# UART1 depends on the UART0 driver symbol, not on BL616CL_UART0, so that
# the menu shows it beside UART0 instead of inside the UART0 menu.

menuconfig BL616CL_UART1
	bool "UART1"
	default n
	depends on UART0_SERIALDRIVER
	select UART1_SERIALDRIVER
	---help---
		Build the UART1 standard serial lower-half. Board code owns pin
		selection and /dev/ttyS1 registration. UART1 console, flow control,
		and RX/TX DMA are not supported by this lower-half. The BL616CL
		integration requires UART0 to remain the serial console.

if BL616CL_UART1

config UART1_BITS
	range 5 8

config UART1_2STOP
	range 0 1

endif # BL616CL_UART1

endif # BL616CL_UART

menuconfig BL616CL_WDT
	bool "Watchdog Timer (WDT)"
	default n
	select WATCHDOG
	select BL616CL_WDT_CAPTURE if WATCHDOG_AUTOMONITOR_BY_CAPTURE
	---help---
		Enable the BL616CL watchdog timer lower half driver.
		The timeout unit is milliseconds and the maximum value
		is 63999 ms with the default 32 kHz clock. Capture support
		is selected automatically when automonitor uses capture.

if BL616CL_WDT

config BL616CL_WDT_CAPTURE
	bool "Watchdog interrupt capture"
	default n
	---help---
		Enable watchdog interrupt capture mode and the WDT IRQ handler.

endif # BL616CL_WDT

config BL616CL_SEC_ENG
	bool
	default n
	---help---
		Shared SEC_ENG support: the SEC peripheral clock and the engine
		locks. Selected by the drivers that use the security engine.

menuconfig BL616CL_CRYPTO
	bool "SEC_ENG hardware crypto driver"
	default y
	depends on CRYPTO_CRYPTODEV_HARDWARE
	select BL616CL_SEC_ENG
	---help---
		Register the SEC_ENG engines as the hardware driver of the crypto
		framework (hwcr_init()), used through /dev/crypto and the mbedTLS
		ALT layer. Requests complete synchronously; the driver polls the
		engine with a 100 ms limit per chunk.

if BL616CL_CRYPTO

config BL616CL_CRYPTO_AES
	bool "AES"
	default y
	---help---
		Register AES-CBC (CRYPTO_AES_CBC, CRYPTO_AES_192_CBC and
		CRYPTO_AES_256_CBC, each with 128, 192 or 256-bit keys), AES-CTR
		with a 128-bit counter, and AES-XTS with 128 or 256-bit keys.

config BL616CL_CRYPTO_SHA
	bool "SHA"
	default y
	---help---
		Register SHA-1 and SHA-2 (CRYPTO_SHA1, CRYPTO_SHA2_224,
		CRYPTO_SHA2_256, CRYPTO_SHA2_384 and CRYPTO_SHA2_512). HMAC is not
		registered; mbedTLS builds it from the hash.

config BL616CL_SEC_ENG_BOUNCE_SIZE
	int "Bounce buffer size per engine"
	default 1024
	range 128 65536
	---help---
		Size in bytes of the non-cacheable buffer through which each engine
		reads and writes data, and the largest chunk the engine processes
		at a time. Must be a multiple of 128. The engine does not snoop the
		CPU data cache, so data is copied through this buffer.

menuconfig BL616CL_SEC_ENG_DIRECT
	bool "Run large requests on the caller's buffers"
	default y
	---help---
		Let the engine read and write the caller's buffers directly, with
		the data cache cleaned and invalidated around the run, instead of
		copying through the bounce buffer. Used when the request is at
		least BL616CL_SEC_ENG_DIRECT_MIN bytes, both buffers are in internal
		RAM, the input is word aligned and the output covers whole 32-byte
		cache lines. Other requests, flash and PSRAM buffers, and AES-XTS
		use the bounce buffer.

if BL616CL_SEC_ENG_DIRECT

config BL616CL_SEC_ENG_DIRECT_MIN
	int "Smallest request run on the caller's buffers"
	default 256
	---help---
		Below this size the cache maintenance costs more than the copy
		through the bounce buffer saves.

endif # BL616CL_SEC_ENG_DIRECT

endif # BL616CL_CRYPTO

config BL616CL_TRNG
	bool "True random number generator (TRNG)"
	default CRYPTO_MBEDTLS
	select ARCH_HAVE_RNG
	select BL616CL_SEC_ENG
	imply MBEDTLS_ENTROPY_HARDWARE_ALT
	---help---
		Enable the BL616CL security engine TRNG. DEV_RANDOM controls the
		standard /dev/random device. DEV_URANDOM remains independent and
		uses the same hardware when DEV_URANDOM_ARCH is selected.

		Enabled by default with mbedTLS, which then takes its entropy
		from /dev/random (MBEDTLS_ENTROPY_HARDWARE_ALT) instead of
		getrandom(), whatever DEV_URANDOM implementation is selected.

menuconfig BL616CL_PERFMON
	bool "Performance monitor"
	default n
	---help---
		Count E907 events (I-cache and D-cache accesses and misses,
		conditional branches and mispredicts) with the hardware
		performance counters, and the calls and mcycle of every interrupt
		and exception in riscv_dispatch_irq().  Applications read them
		through arch/chip/bl616cl_perfmon.h; see the perfmon app.  It costs
		about 1.2 KiB of RAM and two CSR reads per interrupt.

if BL616CL_PERFMON

config BL616CL_PERFMON_PCSAMPLE
	bool "Tick PC sampling"
	default y
	---help---
		On every machine timer interrupt, count the interrupted PC in a
		histogram that the caller provides, or count an idle tick when
		the idle task was interrupted.  Code that runs with interrupts
		disabled, other interrupt handlers included, is never sampled;
		its time lands on the code that runs next.

endif # BL616CL_PERFMON

menuconfig BL616CL_DMA0
	bool "DMA0 generic DMA adapter"
	default n
	depends on DMA
	depends on !DMA_LINK
	---help---
		Enable the BL616CL DMA0 adapter for the OpenVela generic DMA API.
		It supports fixed-channel one-shot memory-to-memory and peripheral
		request transfers; with LLI nodes also longer one-shot transfers,
		cyclic transfers and pause/resume of cyclic transfers. The generic
		DMA_LINK interface is not supported.

		Each channel belongs to one user for good. All channels, of SDK
		drivers and of application code, are assigned in "DMA0 channel
		assignment"; the build fails if two users share one.

if BL616CL_DMA0

menu "DMA0 channel assignment"

comment "A driver keeps its channel; channels are never shared"

config BL616CL_I2S_TX_DMA_CHANNEL
	int "I2S0 TX"
	default 0
	range 0 7
	depends on BL616CL_I2S
	---help---
		DMA0 channel for I2S transmit. The I2S driver takes it at
		initialization and keeps it.

config BL616CL_I2S_RX_DMA_CHANNEL
	int "I2S0 RX"
	default 1
	range 0 7
	depends on BL616CL_I2S
	---help---
		DMA0 channel for I2S receive, kept like the TX channel.

config BL616CL_DBI_TX_DMA_CHANNEL
	int "DBI TX"
	default 2
	range 0 7
	depends on BL616CL_DBI_DMA
	---help---
		DMA0 channel that feeds the pixels to the DBI FIFO. The DBI
		display bus takes it when it starts and keeps it. The channel
		FIFO is 64 bytes on CH0 and CH1 and 32 bytes on CH2 and CH3,
		which run INCR8 bursts, and 16 bytes on CH4..CH7, which run INCR4.

config BL616CL_DISPLAY_SPI_TX_DMA_CHANNEL
	int "Display SPI TX"
	default 3
	range 0 7
	depends on BL616CL_DISPLAY_SPI_DMA
	---help---
		DMA0 channel that feeds the pixels to the FIFO of the display SPI
		controller. The display SPI bus takes it when it starts and keeps
		it.

config BL616CL_DMA0_APP_CHANNELS
	hex "Application code"
	default 0x0
	---help---
		Channels that code outside the SDK drivers takes with
		DMA_GET_CHAN, one bit per channel (bit n is CHn, up to 0xff).
		They count as assigned like the SDK driver channels: sharing one
		with an SDK driver fails the build, and tests leave them alone.

endmenu # DMA0 channel assignment

config BL616CL_DMA0_LLI_NODES
	int "DMA0 LLI nodes"
	default 96 if BL616CL_DBI_DMA && BL616CL_DISPLAY_SPI_DMA
	default 56 if BL616CL_DBI_DMA || BL616CL_DISPLAY_SPI_DMA
	default 16
	range 0 255
	---help---
		Linked-list nodes shared by all DMA0 channels, 16 bytes each. A
		one-shot transfer longer than 4095 units takes one node per 4064
		units after the first; a cyclic transfer takes one node per period,
		or more for periods longer than 4095 units. A transfer gets its
		nodes when it starts and returns them when it ends. 0 limits
		one-shot transfers to 4095 units and disables cyclic transfers.
		The default adds 40 nodes for each of the DBI and display SPI
		buses (BL616CL_DBI_DMA_LLI_COUNT, BL616CL_DISPLAY_SPI_DMA_LLI_COUNT),
		so that both can run their largest draw at once, to 16 for the
		other users.

endif # BL616CL_DMA0

menuconfig BL616CL_I2C
	bool "I2C master"
	default n
	select I2C
	select I2C_DRIVER
	---help---
		Enable the BL616CL I2C master lower-half. Transfers are interrupt
		driven by default; set I2C_POLLED (Device Drivers -> I2C Driver
		Support) to poll instead. Board code owns the pin selection and
		/dev/i2cN registration.

if BL616CL_I2C

config BL616CL_I2C0
	bool "I2C0 controller"
	default n
	---help---
		Build the I2C0 master lower-half; the board registers it as a
		NuttX I2C bus.

config BL616CL_I2C1
	bool "I2C1 controller"
	default n
	---help---
		Build the I2C1 master lower-half; the board registers it as a
		NuttX I2C bus.

endif # BL616CL_I2C

menuconfig BL616CL_I2S
	bool "I2S0 master"
	default n
	depends on AUDIO && BL616CL_DMA0
	select I2S
	select SCHED_HPWORK
	---help---
		Enable the BL616CL I2S0 lower-half (struct i2s_dev_s). The chip is
		the I2S master: it drives MCLK through CLKOUT, BCLK and FS, and
		moves samples with DMA0. Board code owns the pin selection and the
		codec registration. The DMA0 channels are set in "DMA0 channel
		assignment".

if BL616CL_I2S

config BL616CL_I2S_NBUFFERS
	int "Queued buffers"
	default 4
	range 2 16
	---help---
		Number of audio buffers the driver can hold at once, for both
		directions. send() and receive() wait for a free slot when all are
		in use.

menuconfig BL616CL_I2S_DMA_RING
	bool "Cyclic DMA ring"
	default y
	---help---
		Move the samples of each direction through a fixed ring with one
		cyclic DMA transfer. The period interrupt copies between the ring
		and the audio buffers, and may come up to the length of the other
		periods late (about 16 ms at 48 kHz with the defaults). TX sends
		silence while no data is queued. A TX buffer finishes when the
		next one goes into the ring, the last one when it has been
		played; buffers shorter than the ring leave silence at the start
		of a stream. Each direction keeps its ring in non-cacheable RAM
		and takes one DMA0 LLI node per period while it runs.

		Without it, each buffer goes out in one-shot DMA chunks of up to
		4095 words, and the DMA interrupt has to start the next chunk
		before the 16-word FIFO runs out, about 333 us at 48 kHz. That
		takes no extra RAM and copies nothing.

if BL616CL_I2S_DMA_RING

config BL616CL_I2S_RING_PERIODS
	int "Periods per ring"
	default 4
	range 2 16
	---help---
		Number of periods in each ring. TX and RX together take twice as
		many DMA0 LLI nodes while both run; the build fails if
		BL616CL_DMA0_LLI_NODES is smaller.

config BL616CL_I2S_RING_PERIOD_BYTES
	int "Period size in bytes"
	default 1024
	range 64 16380
	---help---
		Bytes per period, a multiple of 4 (one 16-bit stereo frame).
		1024 bytes is 256 frames, 5.33 ms at 48 kHz. Each direction has a
		static ring of this size times BL616CL_I2S_RING_PERIODS.

endif # BL616CL_I2S_DMA_RING

endif # BL616CL_I2S

menuconfig BL616CL_SPI
	bool "SPI master"
	default n
	select SPI
	select SPI_EXCHANGE
	select ARCH_HAVE_SPI_BITORDER
	---help---
		Enable the BL616CL polling SPI master lower-half. Board code owns
		pin selection, chip-select mapping, and /dev/spiN registration.

if BL616CL_SPI

config BL616CL_SPI0
	bool "SPI0 controller"
	default n
	---help---
		Build the SPI0 master lower-half; the board registers it as
		SPI bus 0.

config BL616CL_SPI1
	bool "SPI1 controller"
	default n
	---help---
		Build the independent SPI1 lower-half. The Ai-M64P-32S-Kit SPI1
		four-wire pin mapping is not yet verified, so board registration is
		intentionally unavailable.

endif # BL616CL_SPI

config BL616CL_PWM
	bool "Pulse-width modulation (PWM)"
	default n
	depends on PWM
	depends on !PWM_PULSECOUNT
	depends on !PWM_FREQUENCY_FIXED
	depends on !PWM_DEADTIME
	---help---
		Enable the BL616CL PWM0 lower-half for continuous output. The four
		channels share one counter and always run at the same frequency.
		Each channel drives a positive output, a negative output that is its
		complement, or both. If no channel has a negative output, the
		single-ended pin layout is used, which offers twice as many pins
		for positive outputs. With PWM_MULTICHAN, channel numbers 1 to 4
		select channels 0 to 3; without it the board configures exactly one
		channel. Pulse count, fixed-point frequency and dead-time ABIs are
		not supported.

menuconfig BL616CL_ADC
	bool "General-purpose ADC (GPADC)"
	default n
	select ANALOG
	select ADC
	---help---
		Enable the BL616CL GPADC lower-half for the ADC upper-half driver.
		Board code selects the external channels, which are scanned in a
		fixed order as single-ended 16-bit conversions against the
		internal reference. read() returns the channel number and the
		calibrated input in millivolts (0 to 3200). ANIOC_TRIGGER starts
		the conversions as set by the transfer mode below.

if BL616CL_ADC

choice
	prompt "Transfer mode"
	default BL616CL_ADC_POLL

config BL616CL_ADC_POLL
	bool "Polled single scan"
	---help---
		Each ANIOC_TRIGGER converts every channel once, waits for the
		results in the calling task and queues them before it returns.
		Takes no interrupt or worker.

config BL616CL_ADC_IRQ
	bool "Interrupt-driven continuous scan"
	select SCHED_HPWORK
	---help---
		ANIOC_TRIGGER starts a continuous scan that runs until the last
		close. The FIFO interrupt hands the samples to the high priority
		work queue, which queues them for read(). If samples are lost,
		because the work queue or the reader falls behind, the scan
		stops: read() returns the samples taken before the loss, then
		fails once with EIO, and ANIOC_TRIGGER starts a new scan.

endchoice # Transfer mode

config BL616CL_ADC_CLK_DIV
	int "ADC clock divider"
	default 20 if BL616CL_ADC_POLL
	default 64
	range 20 64
	---help---
		The ADC clock is the 40 MHz XCLK divided by this value. One
		16-bit sample takes about 129 us at 20 (2 MHz, the native SDK
		setting; faster clocks are not validated) and about 376 us at
		64. The slower clock gives the work queue more time to drain the
		16-sample FIFO in the interrupt-driven mode.

endif # BL616CL_ADC

menuconfig BL616CL_RTC
	bool "Real-time clock (RTC)"
	default n
	select RTC
	select RTC_DATETIME
	select RTC_DRIVER
	select RTC_ARCH
	select ARCH_HAVE_RTC_SUBSECONDS
	---help---
		Enable the BL616CL HBN 48-bit counter as the OpenVela wall-clock
		RTC and register the standard /dev/rtc0 device. The system timer
		continues to provide elapsed time.

if BL616CL_RTC

choice
	prompt "RTC F32K clock source"
	default BL616CL_RTC_CLOCK_DIG32K

config BL616CL_RTC_CLOCK_RC32K
	bool "Internal RC32K"
	---help---
		Use the always-on internal RC32K oscillator. This source has no
		external dependency but has lower frequency accuracy. RTC conversion
		uses the SDK nominal F32K frequency of 32768 Hz; actual drift must be
		measured on the target board.

config BL616CL_RTC_CLOCK_DIG32K
	bool "40 MHz crystal divided clock"
	---help---
		Derive the RTC clock from the 40 MHz crystal through the fixed
		1221 divider. RTC conversion uses the resulting rational frequency,
		40000000 / 1221 Hz, instead of assuming exactly 32768 Hz.

endchoice

config BL616CL_RTC_ALARM
	bool "RTC alarm"
	default n
	select RTC_ALARM
	---help---
		Enable one standard absolute or relative RTC alarm using the full
		48-bit HBN compare and the HBN_OUT0 interrupt. This option owns the
		shared HBN_OUT0 IRQ until a common HBN dispatcher is introduced.
		Changing RTC time reprograms an active absolute alarm. If the new time
		passes the alarm, the alarm expires immediately.

endif # BL616CL_RTC

config BL616CL_ONESHOT
	bool "One-shot timer"
	default n
	select ONESHOT
	---help---
		Enable the BL616CL TIMER1 one-shot lower-half driver.

menuconfig BL616CL_TIMER
	bool "Timer"
	default n
	select TIMER
	---help---
		Enable the BL616CL timer lower-half driver.

if BL616CL_TIMER

config BL616CL_TIMER0
	bool "Timer 0"
	default y
	---help---
		Enable the BL616CL TIMER0 ordinary timer lower-half, registered
		as /dev/timer0.

config BL616CL_TIMER1
	bool "Timer 1"
	default n
	depends on !BL616CL_ONESHOT
	---help---
		Enable the BL616CL TIMER1 ordinary timer lower-half. TIMER1 is
		shared with the one-shot driver and is therefore mutually exclusive.

endif # BL616CL_TIMER

menuconfig BL616CL_GPIO
	bool "GPIO Controller (ioexpander)"
	default n
	select IOEXPANDER
	select DEV_GPIO
	select GPIO_LOWER_HALF
	select IOEXPANDER_INT_ENABLE
	---help---
		Enable the BL616CL GPIO controller driver based on the
		ioexpander framework. Board code registers individual
		pins as /dev/gpioN devices via gpio_lower_half().

if BL616CL_GPIO

if IOEXPANDER_INT_ENABLE

config BL616CL_GPIO_INT_NCALLBACKS
	int "Number of GPIO interrupt callbacks"
	default 4
	range 1 255
	---help---
		Number of interrupt callbacks the GPIO I/O expander can hold at
		the same time.

endif # IOEXPANDER_INT_ENABLE
endif # BL616CL_GPIO

endmenu

menuconfig BL616CL_DISPLAY
	bool "Display"
	default n
	select BL_COMPONENT_DISPLAY
	---help---
		Enable the display framework of the Bouffalo SDK
		(components/display) with the BL616CL controller backends. Board
		code defines the bus, the panel module and its control pins, and
		registers the display as a NuttX LCD device.

if BL616CL_DISPLAY

menuconfig BL616CL_DBI
	bool "DBI controller bus"
	default y
	---help---
		Display bus on the DBI controller: MIPI DBI type B (8080, 8 data
		lines), type C 3-wire and 4-wire, and QSPI panels. Commands and
		parameters are written to the FIFO by the CPU.

if BL616CL_DBI

config BL616CL_DBI_CLK_MODE
	int "Clock polarity and phase of the serial interfaces"
	default 1
	range 0 3
	---help---
		DBI_CLOCK_MODE_0..3 of the type C and QSPI interfaces, common to
		all endpoints of the bus. The SDK default is 1.

menuconfig BL616CL_DBI_DMA
	bool "Send pixels with DMA0"
	default y
	depends on BL616CL_DMA0
	---help---
		DMA0 feeds the pixels to the DBI FIFO and the draw ends with the
		DBI transfer-complete interrupt. Without it the CPU writes the
		pixels to the FIFO, which is meant for bring-up and debugging.
		The channel is set in "DMA0 channel assignment".

if BL616CL_DBI_DMA

config BL616CL_DBI_DMA_LLI_COUNT
	int "DMA0 LLI nodes per draw"
	default 40
	range 1 255
	---help---
		Largest draw, in DMA0 LLI nodes of 16256 bytes: 40 nodes carry
		650240 bytes, two 320x480 RGB565 frames. A draw takes its nodes
		from BL616CL_DMA0_LLI_NODES while it runs; the build fails if that
		pool holds fewer than this count minus one.

endif # BL616CL_DBI_DMA

endif # BL616CL_DBI

menuconfig BL616CL_DISPLAY_SPI
	bool "SPI controller bus"
	default n
	depends on !BL616CL_SPI0 || !BL616CL_SPI1
	---help---
		Display bus on an SPI controller: MIPI DBI type C 4-wire (SCK,
		MOSI, DC on a GPIO) with RGB565 and XRGB8888 pixels. Commands and
		parameters are sent by polling. The controller belongs to the
		display and cannot also be a NuttX SPI bus, so one of SPI0 and
		SPI1 must be free.

if BL616CL_DISPLAY_SPI

choice
	prompt "SPI controller"
	default BL616CL_DISPLAY_SPI_PORT0

config BL616CL_DISPLAY_SPI_PORT0
	bool "SPI0"
	depends on !BL616CL_SPI0

config BL616CL_DISPLAY_SPI_PORT1
	bool "SPI1"
	depends on !BL616CL_SPI1

endchoice

config BL616CL_DISPLAY_SPI_MODE
	int "SPI mode"
	default 0
	range 0 3
	---help---
		Clock polarity and phase, common to all endpoints of the bus.

menuconfig BL616CL_DISPLAY_SPI_DMA
	bool "Send pixels with DMA0"
	default y
	depends on BL616CL_DMA0
	---help---
		DMA0 feeds the pixels to the SPI FIFO; the draw ends when the DMA
		has finished and the controller is idle. Without it the CPU sends
		the pixels by polling. The channel is set in "DMA0 channel
		assignment".

if BL616CL_DISPLAY_SPI_DMA

config BL616CL_DISPLAY_SPI_DMA_LLI_COUNT
	int "DMA0 LLI nodes per draw"
	default 40
	range 1 255
	---help---
		Largest draw, in DMA0 LLI nodes of 4064 16-bit units: 40 nodes
		carry 325120 bytes, two 240x320 RGB565 frames. A draw takes its
		nodes from BL616CL_DMA0_LLI_NODES while it runs; the build fails
		if that pool holds fewer than this count minus one.

endif # BL616CL_DISPLAY_SPI_DMA

endif # BL616CL_DISPLAY_SPI

config BL616CL_DISPLAY_SOFT_DBI_C
	bool "Software DBI type C bus"
	default n
	---help---
		Display bus bit-banged on GPIOs: MIPI DBI type C 3-wire, and
		4-wire with a DC pin. Synchronous and slow; used for the command
		port of RGB panels or small panels.

endif # BL616CL_DISPLAY

config BL616CL_TOUCH
	bool "Touch panel"
	default n
	select BL_COMPONENT_TOUCH
	select INPUT
	select INPUT_TOUCHSCREEN
	select SCHED_LPWORK
	---help---
		Enable the I2C touch controller drivers of the Bouffalo SDK
		(components/display/touch) as a NuttX touchscreen. The controller
		is read periodically from the low-priority work queue; board code
		picks the controller and registers /dev/inputN.

menuconfig BL616CL_WIRELESS
	bool "BL616CL wireless"
	default n
	select BL_COMPONENT_RFPARAM
	---help---
		Wi-Fi and BLE on the BL616CL radio. Both need the RF parameters
		(rfparam) that are loaded from flash before the radio starts.

if BL616CL_WIRELESS

menuconfig BL616CL_WIRELESS_WIFI
	bool "Wi-Fi station"
	default n
	select BL_COMPONENT_MACSW
	select BL_COMPONENT_WPA_SUPPLICANT
	select BL_COMPONENT_WL80211
	select BL616CL_TRNG
	---help---
		Wi-Fi station on the wl80211 stack with the macsw MAC firmware
		and the WPA supplicant, registered as the wlan0 network device.
		The supplicant and the mbedTLS entropy source read /dev/urandom,
		which BL616CL_TRNG makes default to the hardware TRNG.

if BL616CL_WIRELESS_WIFI

config BL616CL_WLAN_RX_ZEROCOPY
	bool "Wi-Fi RX zero-copy"
	default n
	select IOB_ALLOC
	---help---
		Hand received Wi-Fi frames of 500 bytes or more to the network
		stack in their wl80211 host RX slot, wrapped as an IOB that
		returns the slot when freed, instead of copying them into pool
		IOBs. Slots lent out are capped so that one BA session can still
		reorder; beyond the cap, and for short frames, frames are copied.
		A reply that the stack builds in a slot is copied into pool IOBs
		before it is sent. IOB_ALLOC adds 12 bytes to every pool IOB.

config BL616CL_FW_TASK_PRIORITY
	int "Wi-Fi firmware task priority"
	default 130
	---help---
		Priority of the "wifi_fw" task, which runs the MAC firmware and
		hands received frames to the driver.  Keep it below the work
		queue that runs the network stack (LPWORK, or HPWORK when
		SCHED_LPWORK is off) and above applications, so that it always
		preempts them.  With the network stack at 120, below this task,
		TCP TX dropped by about a quarter and UDP TX by about a third.
		At the priority of iperf (100) UDP RX overload got close to line
		rate and UDP TX lost 1-2 Mbit/s; below it (90) UDP TX lost 6-12
		Mbit/s.

menuconfig BL616CL_WIRELESS_WIFI_SOFTAP
	bool "Wi-Fi SoftAP"
	default n
	---help---
		SoftAP on the wl80211 AP interface, registered as a second
		network device, wlan1, next to the station wlan0.  It is driven
		with the standard wireless ioctls (wapi): SIOCSIWESSID with
		IW_ESSID_ON starts the AP, IW_ESSID_OFF or bringing wlan1 down
		stops it.  The AP is open, or WPA2-PSK (CCMP) once a passphrase
		is set, on 2.4 GHz with 20 MHz.  wlan1 gets no address from the
		driver; set one and run a DHCP server, e.g. dhcpd_start wlan1.

if BL616CL_WIRELESS_WIFI_SOFTAP

config BL616CL_WIRELESS_WIFI_SOFTAP_MAX_STA
	int "Maximum number of clients"
	range 1 4
	default 4
	---help---
		Clients the SoftAP accepts at a time; further association
		requests are refused.  wl80211 has room for four.

config BL616CL_WIRELESS_WIFI_SOFTAP_IDLE_TIMEOUT
	int "Idle client timeout (seconds)"
	range 0 2145
	default 300
	---help---
		A client the AP has received nothing from for this long is
		deauthenticated, so that clients which left without a deauth
		do not keep a place.  wl80211 checks every 5 seconds and the
		value is rounded up to a multiple of 5.  0 disables it.  The
		limit comes from the 32-bit microsecond timer wl80211 uses.

config BL616CL_WIRELESS_WIFI_SOFTAP_HIDDEN
	bool "Hide the SSID"
	default n
	---help---
		Beacons carry an empty SSID and wildcard probe requests are
		not answered, so clients have to be given the SSID.  WPS is not
		advertised, as WSC 2.0 requires for a hidden AP.  The SSID is
		still sent in probe responses and by the clients; this does not
		protect the network.

endif # BL616CL_WIRELESS_WIFI_SOFTAP

endif # BL616CL_WIRELESS_WIFI

menuconfig BL616CL_WIRELESS_BLE
	bool "BLE controller"
	default n
	depends on !BL616CL_EM_NONE
	depends on UART_BTH4
	select BL_COMPONENT_BLE
	---help---
		Link the prebuilt BL616CL BLE controller (m2s1: BLE only, two
		connections, all roles, 16 KiB EM) and register it as the H4
		pseudo device /dev/ttyHCI<BLUETOOTH_DEVICE_ID> for a host stack
		such as zblue.

if BL616CL_WIRELESS_BLE

config BL616CL_WIRELESS_BLE_PRIORITY
	int "Controller thread priority"
	default 200
	---help---
		The controller thread runs the link-layer scheduler after every
		BLE interrupt. Keep it above LPWORK (Wi-Fi) and the Wi-Fi firmware
		task, and below HPWORK.

config BL616CL_WIRELESS_BLE_STACKSIZE
	int "Controller thread stack size"
	default 3072

endif # BL616CL_WIRELESS_BLE

endif # BL616CL_WIRELESS

endif
```
