## chips/bl616cl/Kconfig
```kconfig
#
# For a description of the syntax of this configuration file,
# see the file kconfig-language.txt in the NuttX tools repository.
#

if ARCH_CHIP_CUSTOM

comment "BouffaloLab BL616CL Configuration Options"

choice
	prompt "BouffaloLab Chip Selection"
	default ARCH_CHIP_BL616CL

config ARCH_CHIP_BL616CL
	bool "BL616CL"
	select ARCH_RV32
	select ARCH_HAVE_FPU
	select ARCH_HAVE_MISALIGN_EXCEPTION
	select ARCH_HAVE_RESET
	select ARCH_RV_ISA_M
	select ARCH_RV_ISA_A
	select ARCH_RV_ISA_C
	select ARCH_RV_ISA_ZICSR_ZIFENCEI
	select ONESHOT
	select ONESHOT_COUNT
	select ONESHOT_FAST_DIVISION
	select ALARM_ARCH
	---help---
		BouffaloLab BL616CL E907 platform.

endchoice

menu "BL616CL Memory Layout"

choice
	prompt "BLE exchange memory (EM)"
	default BL616CL_EM_NONE
	---help---
		EM is carved from the top of WRAM for the BLE controller. The boot
		code programs GLB EM_SEL to match, and the linker script shrinks
		ram_wifi by the same amount. The CMake build does not regenerate
		the linker script when only the configuration changes, so run
		"vela clean" after changing this or BL616CL_WRAM_SIZE.

config BL616CL_EM_NONE
	bool "None"

config BL616CL_EM_16K
	bool "16 KiB"

config BL616CL_EM_32K
	bool "32 KiB"

endchoice

config BL616CL_EM_SIZE
	int
	default 32 if BL616CL_EM_32K
	default 16 if BL616CL_EM_16K
	default 0

config BL616CL_WRAM_SIZE
	int "WRAM size (KiB)"
	range 64 160
	default 160 if BL616CL_EM_32K
	default 144 if BL616CL_EM_16K
	default 128
	---help---
		WRAM is taken from the top of the 384 KiB OCRAM+WRAM window and the
		rest is system RAM. ram_wifi is WRAM minus EM and holds .wifibss
		(macsw shared data, wl80211 RX buffers and the IOB pool). The
		defaults keep ram_wifi at 128 KiB for every EM size, as the
		Bouffalo SDK does by carving EM out of a larger WRAM.

endmenu

menu "BL616CL Peripheral Support"

config BL616CL_CACHE
	bool "OpenVela cache maintenance API"
	default y
	select ARCH_ICACHE
	select ARCH_DCACHE
	---help---
		Expose the BL616CL instruction and data cache through the complete
		OpenVela cache API. I-cache and D-cache are selected together because
		the coherent-cache ABI requires both implementations. The boot path
		continues to enable hardware caches when this option is disabled.

config BL616CL_PSRAM
	bool "Winbond x8 PSRAM heap"
	default n
	depends on BUILD_FLAT && !MM_SMALL && MM_REGIONS >= 2
	depends on !PMP_NO_INIT
	select BL616CL_CACHE
	---help---
		Initialize Winbond x8 PSRAM and add its detected
		4, 8 or 16 MiB capacity to the default heap. Initialization failures
		are reported on the early console and leave PSRAM out of the heap.
		Without factory trim, calibrate DQS using the first 4 MiB before
		heap registration. Corrupt factory trim and 32 MiB devices are not
		supported. This option does not place static sections in PSRAM.

menuconfig BL616CL_UART
	bool "UART"
	default y
	select ARCH_HAVE_SERIAL_TERMIOS

if BL616CL_UART

config BL616CL_UART0
	bool "UART0"
	default y
	select UART0_SERIALDRIVER

if BL616CL_UART0

config BL616CL_UART0_RXPIN
	int "UART0 RX pin"
	range 0 36
	default 35

config BL616CL_UART0_TXPIN
	int "UART0 TX pin"
	range 0 36
	default 34

endif # BL616CL_UART0

config BL616CL_UART1
	bool "UART1"
	default n
	depends on BL616CL_UART0
	select UART1_SERIALDRIVER
	---help---
		Build the UART1 standard serial lower-half. Board code owns pin
		selection and /dev/ttyS1 registration. UART1 console, flow control,
		and RX/TX DMA are not supported by this lower-half. The BL616CL
		integration requires UART0 to remain the serial console.

if BL616CL_UART1

config UART1_BITS
	range 5 8

config UART1_2STOP
	range 0 1

endif # BL616CL_UART1

endif # BL616CL_UART

config BL616CL_WDT
	bool "Watchdog Timer (WDT)"
	default n
	select WATCHDOG
	select BL616CL_WDT_CAPTURE if WATCHDOG_AUTOMONITOR_BY_CAPTURE
	---help---
		Enable the BL616CL watchdog timer lower half driver.
		The timeout unit is milliseconds and the maximum value
		is 63999 ms with the default 32 kHz clock. Capture support
		is selected automatically when automonitor uses capture.

config BL616CL_WDT_CAPTURE
	bool "Watchdog interrupt capture"
	default n
	depends on BL616CL_WDT
	---help---
		Enable watchdog interrupt capture mode and the WDT IRQ handler.

config BL616CL_TRNG
	bool "True random number generator (TRNG)"
	default n
	select ARCH_HAVE_RNG
	---help---
		Enable the BL616CL security engine TRNG. DEV_RANDOM controls the
		standard /dev/random device. DEV_URANDOM remains independent and
		uses the same hardware when DEV_URANDOM_ARCH is selected.

config BL616CL_PERFMON
	bool "Performance monitor"
	default n
	---help---
		Count E907 events (I-cache and D-cache accesses and misses,
		conditional branches and mispredicts) with the hardware
		performance counters, and the calls and mcycle of every interrupt
		and exception in riscv_dispatch_irq().  Applications read them
		through arch/chip/bl616cl_perfmon.h; see the perfmon app.  It costs
		about 1.2 KiB of RAM and two CSR reads per interrupt.

config BL616CL_PERFMON_PCSAMPLE
	bool "Tick PC sampling"
	default y
	depends on BL616CL_PERFMON
	---help---
		On every machine timer interrupt, count the interrupted PC in a
		histogram that the caller provides, or count an idle tick when
		the idle task was interrupted.  Code that runs with interrupts
		disabled, other interrupt handlers included, is never sampled;
		its time lands on the code that runs next.

config BL616CL_WLAN_RX_ZEROCOPY
	bool "Wi-Fi RX zero-copy"
	default n
	depends on BL_COMPONENT_WL80211
	select IOB_ALLOC
	---help---
		Hand received Wi-Fi frames of 500 bytes or more to the network
		stack in their wl80211 host RX slot, wrapped as an IOB that
		returns the slot when freed, instead of copying them into pool
		IOBs. Slots lent out are capped so that one BA session can still
		reorder; beyond the cap, and for short frames, frames are copied.
		A reply that the stack builds in a slot is copied into pool IOBs
		before it is sent. IOB_ALLOC adds 12 bytes to every pool IOB.

config BL616CL_DMA0
	bool "DMA0 generic DMA adapter"
	default n
	depends on DMA
	depends on !DMA_LINK
	---help---
		Enable the BL616CL DMA0 adapter for the OpenVela generic DMA API.
		The first revision supports fixed-channel memory-to-memory transfers
		only. Peripheral request users, linked lists, cyclic transfers, and
		pause/resume are intentionally excluded.

if BL616CL_DMA0

config BL616CL_DMA0_TEST
	bool
	default n
	---help---
		Build test-only DMA0 IRQ injection, start hold, and runtime diagnostics.
		Product configurations must keep this option disabled.

endif # BL616CL_DMA0

menuconfig BL616CL_I2C
	bool "I2C master"
	default n
	select I2C
	select I2C_DRIVER
	select I2C_POLLED
	---help---
		Enable the BL616CL polling I2C master lower-half. Board code owns
		the pin selection and /dev/i2cN registration.

if BL616CL_I2C

config BL616CL_I2C0
	bool "I2C0 controller"
	default n

config BL616CL_I2C1
	bool "I2C1 controller"
	default n

config BL616CL_I2C_TEST
	bool
	default n
	---help---
		Enable the test-only transport hook used by the vendor I2C contract
		tests. Product configurations must leave this option disabled.

endif # BL616CL_I2C

menuconfig BL616CL_SPI
	bool "SPI master"
	default n
	select SPI
	select SPI_EXCHANGE
	select ARCH_HAVE_SPI_BITORDER
	---help---
		Enable the BL616CL polling SPI master lower-half. Board code owns
		pin selection, chip-select mapping, and /dev/spiN registration.

if BL616CL_SPI

config BL616CL_SPI0
	bool "SPI0 controller"
	default n

config BL616CL_SPI1
	bool "SPI1 controller"
	default n
	---help---
		Build the independent SPI1 lower-half. The Ai-M64L-32S-Kit SPI1
		four-wire pin mapping is not yet verified, so board registration is
		intentionally unavailable.

config BL616CL_SPI_TEST
	bool
	default n
	---help---
		Enable test-only transport and diagnostic hooks. Product
		configurations must leave this option disabled.

endif # BL616CL_SPI

config BL616CL_PWM
	bool "Pulse-width modulation (PWM)"
	default n
	depends on PWM
	depends on !PWM_PULSECOUNT
	depends on !PWM_MULTICHAN
	depends on !PWM_FREQUENCY_FIXED
	depends on !PWM_DEADTIME
	---help---
		Enable the BL616CL PWM lower-half for one continuous-output channel.
		The initial board integration uses PWM0 channel 3 positive output.
		Pulse count, multichannel, fixed-point frequency, and dead-time ABIs
		are intentionally excluded until their hardware paths are adapted.

if BL616CL_PWM

config BL616CL_PWM_TEST
	bool
	default n
	---help---
		Enable test-only timeout injection and diagnostic hooks. Product
		configurations must leave this option disabled.

endif # BL616CL_PWM

menuconfig BL616CL_RTC
	bool "Real-time clock (RTC)"
	default n
	select RTC
	select RTC_DATETIME
	select RTC_DRIVER
	select RTC_ARCH
	select ARCH_HAVE_RTC_SUBSECONDS
	---help---
		Enable the BL616CL HBN 48-bit counter as the OpenVela wall-clock
		RTC and register the standard /dev/rtc0 device. The system timer
		continues to provide elapsed time.

if BL616CL_RTC

choice
	prompt "RTC F32K clock source"
	default BL616CL_RTC_CLOCK_DIG32K

config BL616CL_RTC_CLOCK_RC32K
	bool "Internal RC32K"
	---help---
		Use the always-on internal RC32K oscillator. This source has no
		external dependency but has lower frequency accuracy. RTC conversion
		uses the SDK nominal F32K frequency of 32768 Hz; actual drift must be
		measured on the target board.

config BL616CL_RTC_CLOCK_DIG32K
	bool "40 MHz crystal divided clock"
	---help---
		Derive the RTC clock from the 40 MHz crystal through the fixed
		1221 divider. RTC conversion uses the resulting rational frequency,
		40000000 / 1221 Hz, instead of assuming exactly 32768 Hz.

endchoice

config BL616CL_RTC_ALARM
	bool "RTC alarm"
	default n
	select RTC_ALARM
	---help---
		Enable one standard absolute or relative RTC alarm using the full
		48-bit HBN compare and the HBN_OUT0 interrupt. This option owns the
		shared HBN_OUT0 IRQ until a common HBN dispatcher is introduced.
		Changing RTC time reprograms an active absolute alarm. If the new time
		passes the alarm, the alarm expires immediately.

endif # BL616CL_RTC

config BL616CL_ONESHOT
	bool "One-shot timer"
	default n
	select ONESHOT
	---help---
		Enable the BL616CL TIMER1 one-shot lower-half driver.

config BL616CL_TIMER
	bool "Timer"
	default n
	select TIMER
	---help---
		Enable the BL616CL timer lower-half driver.

if BL616CL_TIMER

config BL616CL_TIMER0
	bool "Timer 0"
	default y

config BL616CL_TIMER1
	bool "Timer 1"
	default n
	depends on !BL616CL_ONESHOT
	---help---
		Enable the BL616CL TIMER1 ordinary timer lower-half. TIMER1 is
		shared with the one-shot driver and is therefore mutually exclusive.

config BL616CL_TIMER_TEST
	bool
	default n
	depends on BL616CL_TIMER
	---help---
		Enable the test-only lower-half callback contract hook. This is
		selected by the vendor timer test and must remain disabled in
		product configurations.

endif # BL616CL_TIMER

config BL616CL_GPIO
	bool "GPIO Controller (ioexpander)"
	default n
	select IOEXPANDER
	select DEV_GPIO
	select GPIO_LOWER_HALF
	select IOEXPANDER_INT_ENABLE
	---help---
		Enable the BL616CL GPIO controller driver based on the
		ioexpander framework. Board code registers individual
		pins as /dev/gpioN devices via gpio_lower_half().

if BL616CL_GPIO

if IOEXPANDER_INT_ENABLE

config BL616CL_GPIO_INT_NCALLBACKS
	int "Number of GPIO interrupt callbacks"
	default 4
	range 1 255

endif # IOEXPANDER_INT_ENABLE
endif # BL616CL_GPIO

endmenu

endif
```

## components/macsw/Kconfig
```kconfig
# SPDX-License-Identifier: Apache-2.0

config BL_COMPONENT_MACSW
	bool "Bouffalo macsw"
	depends on ARCH_CHIP_BL616CL

config MACSW_SELECT
	string
	default "default"
	depends on BL_COMPONENT_MACSW
```

## components/wireless/ble/Kconfig
```kconfig
# SPDX-License-Identifier: Apache-2.0

config BL_COMPONENT_BLE
	bool
	depends on ARCH_CHIP_BL616CL
	select BL_COMPONENT_RFPARAM
	help
	  Selected by BL616CL_WIRELESS_BLE. Links the prebuilt BL616CL BLE
	  controller library; the HCI transport and the NuttX port of the
	  library are built from chips/bl616cl.
```

## components/wireless/rfparam/Kconfig
```kconfig
# SPDX-License-Identifier: Apache-2.0

config BL_COMPONENT_RFPARAM
	bool
	depends on ARCH_CHIP_BL616CL
	help
	  Selected by BL616CL_WIRELESS. Builds the BL616CL RF parameter
	  sources from the drivers tree (rfparam adapter, Flash OTP and RFTLV
	  parsing) with the NuttX shims they need.
```

## components/wireless/wifi/bl_wpa_supplicant/Kconfig
```kconfig
# SPDX-License-Identifier: Apache-2.0

config BL_COMPONENT_WPA_SUPPLICANT
    bool "Bouffalo WPA supplicant"
    depends on ARCH_CHIP_BL616CL
    select CRYPTO_MBEDTLS
    select MBEDTLS_PKCS5_C
    select MBEDTLS_CIPHER_MODE_CTR
    select MBEDTLS_CIPHER_PADDING_PKCS7
    select MBEDTLS_ECP_DP_SECP256R1_ENABLED
    select MBEDTLS_ECP_C
    select MBEDTLS_ECDH_C
    select MBEDTLS_ECDSA_C
    select MBEDTLS_PK_WRITE_C
    select MBEDTLS_SHA512_C
    help
      Build the public Bouffalo supplicant sources with a NuttX OS port
      and the OpenVela mbedTLS library for wl80211. WPS and P2P are not
      enabled by this integration.
```

## components/wireless/wifi/macsw/Kconfig
```kconfig
# SPDX-License-Identifier: Apache-2.0

config BL_COMPONENT_MACSW
	bool
	depends on ARCH_CHIP_BL616CL
	help
	  Selected by BL616CL_WIRELESS_WIFI. Builds the macsw MAC firmware
	  core, from source or from the prebuilt archive.

config MACSW_SELECT
	string
	default "vela_bl616cl"
	depends on BL_COMPONENT_MACSW
```

## components/wireless/wifi/wl80211/Kconfig
```kconfig
# SPDX-License-Identifier: Apache-2.0

config BL_COMPONENT_WL80211
    bool "Bouffalo wl80211"
    depends on ARCH_CHIP_BL616CL
    depends on BL_COMPONENT_MACSW
    depends on BL_COMPONENT_WPA_SUPPLICANT
    select BL_COMPONENT_RFPARAM
    help
      Build the wl80211 BL616CL/vela_bl616cl core archive with the
      standalone CMake flow and register it for the kernel link, plus the
      NuttX host port sources of the public wl80211 repository. FreeRTOS
      and lwIP platform sources are excluded; the BL616CL netdev and
      adapter are built from chips/bl616cl.
```
