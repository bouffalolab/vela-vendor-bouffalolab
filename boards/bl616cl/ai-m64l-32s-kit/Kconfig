## boards/bl616cl/ai-m64l-32s-kit/Kconfig
```kconfig
#

menuconfig AI_M64L_KIT_UART1
	bool "Ai-M64L-32S-Kit UART1"
	default n
	depends on BL616CL_UART0
	select BL616CL_UART1
	---help---
		Register UART1 as /dev/ttyS1 using the board-owned GPIO14 TX and
		GPIO15 RX test loopback pair. Runtime termios is independently
		controlled by SERIAL_TERMIOS.

menuconfig AI_M64L_KIT_I2C
	bool "Ai-M64L-32S-Kit I2C buses"
	default n
	select BL616CL_I2C
	---help---
		Register the selected board I2C buses. External 3.3 V targets and
		SCL/SDA pull-ups are required.

if AI_M64L_KIT_I2C

config AI_M64L_KIT_I2C0
	bool "Register I2C0"
	default y
	select BL616CL_I2C0

if AI_M64L_KIT_I2C0

config AI_M64L_KIT_I2C0_SCL_PIN
	int "I2C0 SCL pin"
	range 0 36
	default 4

config AI_M64L_KIT_I2C0_SDA_PIN
	int "I2C0 SDA pin"
	range 0 36
	default 5

endif # AI_M64L_KIT_I2C0

config AI_M64L_KIT_I2C1
	bool "Register I2C1"
	default n
	select BL616CL_I2C1

if AI_M64L_KIT_I2C1

config AI_M64L_KIT_I2C1_SCL_PIN
	int "I2C1 SCL pin"
	range 0 36
	default 12

config AI_M64L_KIT_I2C1_SDA_PIN
	int "I2C1 SDA pin"
	range 0 36
	default 13

endif # AI_M64L_KIT_I2C1
endif # AI_M64L_KIT_I2C

menuconfig AI_M64L_KIT_SPI
	bool "Ai-M64L-32S-Kit SPI buses"
	default n
	select BL616CL_SPI
	---help---
		Register board-selected SPI master buses. SPI0 uses GPIO chip select
		and exposes the OpenVela test device as /dev/spi0.

if AI_M64L_KIT_SPI

config AI_M64L_KIT_SPI0
	bool "Register SPI0"
	default y
	depends on !AI_M64L_KIT_I2C1
	select BL616CL_SPI0
	select SPI_DRIVER
	---help---
		Register SPI0 using the selected BL616CLDK-derived pin mapping.
		This setting owns the selected pins instead of the board GPIO tests.

if AI_M64L_KIT_SPI0

config AI_M64L_KIT_SPI0_CS_PIN
	int "SPI0 GPIO chip-select pin"
	range 0 36
	default 12

config AI_M64L_KIT_SPI0_CLK_PIN
	int "SPI0 clock pin"
	range 0 36
	default 13

config AI_M64L_KIT_SPI0_MISO_PIN
	int "SPI0 MISO pin"
	range 0 36
	default 18

config AI_M64L_KIT_SPI0_MOSI_PIN
	int "SPI0 MOSI pin"
	range 0 36
	default 19

config AI_M64L_KIT_SPI0_CS_ACTIVE_HIGH
	bool "SPI0 chip select is active high"
	default n

config AI_M64L_KIT_SPI0_TARGET_INDEX
	int "SPI0 target 0 SPIDEV_USER index"
	range 0 65535
	default 0

config AI_M64L_KIT_SPI0_TARGET1
	bool "SPI0 target 1"
	default n
	help
	  Enable a second GPIO chip select on SPI0. The target index and GPIO
	  must differ from target 0 and all SPI signal pins.

if AI_M64L_KIT_SPI0_TARGET1

config AI_M64L_KIT_SPI0_TARGET1_CS_PIN
	int "SPI0 target 1 GPIO chip-select pin"
	range 0 36
	default 20

config AI_M64L_KIT_SPI0_TARGET1_CS_ACTIVE_HIGH
	bool "SPI0 target 1 chip select is active high"
	default n

config AI_M64L_KIT_SPI0_TARGET1_INDEX
	int "SPI0 target 1 SPIDEV_USER index"
	range 0 65535
	default 1

endif # AI_M64L_KIT_SPI0_TARGET1

endif # AI_M64L_KIT_SPI0
endif # AI_M64L_KIT_SPI
# For a description of the syntax of this configuration file,
# see the file kconfig-language.txt in the NuttX tools repository.
#
```

## boards/bl616cl/ai-m64p-32s-kit/Kconfig
```kconfig
#

config ARCH_BOARD_AI_M64P_32S_KIT
	def_bool y
	---help---
		Board identity, defined only while this board is selected. Test
		apps that need this board's wiring depend on it.

menuconfig AI_M64P_KIT_UART1
	bool "Ai-M64P-32S-Kit UART1"
	default n
	depends on BL616CL_UART0
	select BL616CL_UART1
	---help---
		Register UART1 as /dev/ttyS1 using the board-owned GPIO14 TX and
		GPIO15 RX test loopback pair. Runtime termios is independently
		controlled by SERIAL_TERMIOS.

menuconfig AI_M64P_KIT_PWM
	bool "Ai-M64P-32S-Kit PWM output"
	default n
	depends on BL616CL_PWM
	---help---
		Register PWM0 as /dev/pwm0 on the selected channels. The channels
		share one frequency. A channel uses a positive output, a negative
		output or both; the negative output is the complement of the
		positive one, also when stopped. Without PWM_MULTICHAN exactly one
		channel must be selected.

		The pin rule depends on the negative pins. While no channel has a
		negative pin, channel n drives positive outputs on GPIOs with
		pin % 4 == n. Once any channel has one, channel n needs
		pin % 8 == 2n for positive and 2n + 1 for negative outputs.

		The selected pins leave the board GPIO test devices and must not be
		used by I2C, SPI or UART1. GPIO28 drives the warm white LED and
		GPIO27 the cold white LED.

if AI_M64P_KIT_PWM

config AI_M64P_KIT_PWM_CH0
	bool "Channel 0"
	default n
	---help---
		Drive PWM0 channel 0. Without negative pins its positive output
		is on a GPIO with pin % 4 == 0; with negative pins the positive
		output needs pin % 8 == 0 and the negative one pin % 8 == 1.

if AI_M64P_KIT_PWM_CH0

config AI_M64P_KIT_PWM_CH0_POS_PIN
	int "Channel 0 positive output GPIO (-1: unused)"
	default 8
	range -1 31

config AI_M64P_KIT_PWM_CH0_NEG_PIN
	int "Channel 0 negative output GPIO (-1: unused)"
	default -1
	range -1 31

endif # AI_M64P_KIT_PWM_CH0

config AI_M64P_KIT_PWM_CH1
	bool "Channel 1"
	default n
	---help---
		Drive PWM0 channel 1. Without negative pins its positive output
		is on a GPIO with pin % 4 == 1; with negative pins the positive
		output needs pin % 8 == 2 and the negative one pin % 8 == 3.

if AI_M64P_KIT_PWM_CH1

config AI_M64P_KIT_PWM_CH1_POS_PIN
	int "Channel 1 positive output GPIO (-1: unused)"
	default 9
	range -1 31

config AI_M64P_KIT_PWM_CH1_NEG_PIN
	int "Channel 1 negative output GPIO (-1: unused)"
	default -1
	range -1 31

endif # AI_M64P_KIT_PWM_CH1

config AI_M64P_KIT_PWM_CH2
	bool "Channel 2"
	default n
	---help---
		Drive PWM0 channel 2. Without negative pins its positive output
		is on a GPIO with pin % 4 == 2; with negative pins the positive
		output needs pin % 8 == 4 and the negative one pin % 8 == 5.

if AI_M64P_KIT_PWM_CH2

config AI_M64P_KIT_PWM_CH2_POS_PIN
	int "Channel 2 positive output GPIO (-1: unused)"
	default 10
	range -1 31

config AI_M64P_KIT_PWM_CH2_NEG_PIN
	int "Channel 2 negative output GPIO (-1: unused)"
	default -1
	range -1 31

endif # AI_M64P_KIT_PWM_CH2

config AI_M64P_KIT_PWM_CH3
	bool "Channel 3"
	default y
	---help---
		Drive PWM0 channel 3. Without negative pins its positive output
		is on a GPIO with pin % 4 == 3; with negative pins the positive
		output needs pin % 8 == 6 and the negative one pin % 8 == 7.

if AI_M64P_KIT_PWM_CH3

config AI_M64P_KIT_PWM_CH3_POS_PIN
	int "Channel 3 positive output GPIO (-1: unused)"
	default 11
	range -1 31

config AI_M64P_KIT_PWM_CH3_NEG_PIN
	int "Channel 3 negative output GPIO (-1: unused)"
	default -1
	range -1 31

endif # AI_M64P_KIT_PWM_CH3

endif # AI_M64P_KIT_PWM

menuconfig AI_M64P_KIT_I2C
	bool "Ai-M64P-32S-Kit I2C buses"
	default n
	select BL616CL_I2C
	---help---
		Register the selected board I2C buses. External 3.3 V targets and
		SCL/SDA pull-ups are required.

if AI_M64P_KIT_I2C

config AI_M64P_KIT_I2C0
	bool "Register I2C0"
	default y
	select BL616CL_I2C0

if AI_M64P_KIT_I2C0

config AI_M64P_KIT_I2C0_SCL_PIN
	int "I2C0 SCL pin"
	range 0 36
	default 4

config AI_M64P_KIT_I2C0_SDA_PIN
	int "I2C0 SDA pin"
	range 0 36
	default 5

endif # AI_M64P_KIT_I2C0

config AI_M64P_KIT_I2C1
	bool "Register I2C1"
	default n
	select BL616CL_I2C1

if AI_M64P_KIT_I2C1

config AI_M64P_KIT_I2C1_SCL_PIN
	int "I2C1 SCL pin"
	range 0 36
	default 12

config AI_M64P_KIT_I2C1_SDA_PIN
	int "I2C1 SDA pin"
	range 0 36
	default 13

endif # AI_M64P_KIT_I2C1
endif # AI_M64P_KIT_I2C

menuconfig AI_M64P_KIT_SPI
	bool "Ai-M64P-32S-Kit SPI buses"
	default n
	select BL616CL_SPI
	---help---
		Register board-selected SPI master buses. SPI0 uses GPIO chip select
		and exposes the OpenVela test device as /dev/spi0.

if AI_M64P_KIT_SPI

config AI_M64P_KIT_SPI0
	bool "Register SPI0"
	default y
	select BL616CL_SPI0
	select SPI_DRIVER
	---help---
		Register SPI0 using the selected BL616CLDK-derived pin mapping.
		This setting owns the selected pins instead of the board GPIO tests.

if AI_M64P_KIT_SPI0

config AI_M64P_KIT_SPI0_CS_PIN
	int "SPI0 GPIO chip-select pin"
	range 0 36
	default 12

config AI_M64P_KIT_SPI0_CLK_PIN
	int "SPI0 clock pin"
	range 0 36
	default 13

config AI_M64P_KIT_SPI0_MISO_PIN
	int "SPI0 MISO pin"
	range 0 36
	default 18

config AI_M64P_KIT_SPI0_MOSI_PIN
	int "SPI0 MOSI pin"
	range 0 36
	default 19

config AI_M64P_KIT_SPI0_CS_ACTIVE_HIGH
	bool "SPI0 chip select is active high"
	default n

config AI_M64P_KIT_SPI0_TARGET_INDEX
	int "SPI0 target 0 SPIDEV_USER index"
	range 0 65535
	default 0

config AI_M64P_KIT_SPI0_TARGET1
	bool "SPI0 target 1"
	default n
	help
	  Enable a second GPIO chip select on SPI0. The target index and GPIO
	  must differ from target 0 and all SPI signal pins.

if AI_M64P_KIT_SPI0_TARGET1

config AI_M64P_KIT_SPI0_TARGET1_CS_PIN
	int "SPI0 target 1 GPIO chip-select pin"
	range 0 36
	default 20

config AI_M64P_KIT_SPI0_TARGET1_CS_ACTIVE_HIGH
	bool "SPI0 target 1 chip select is active high"
	default n

config AI_M64P_KIT_SPI0_TARGET1_INDEX
	int "SPI0 target 1 SPIDEV_USER index"
	range 0 65535
	default 1

endif # AI_M64P_KIT_SPI0_TARGET1

endif # AI_M64P_KIT_SPI0
endif # AI_M64P_KIT_SPI
# For a description of the syntax of this configuration file,
# see the file kconfig-language.txt in the NuttX tools repository.
#
```

## boards/bl616cl/bl616cl-ave-v10/Kconfig
```kconfig
#
# For a description of the syntax of this configuration file,
# see the file kconfig-language.txt in the NuttX tools repository.
#

config ARCH_BOARD_BL616CL_AVE_V10
	def_bool y
	---help---
		Board identity, defined only while this board is selected. Test
		apps that need this board's wiring depend on it.

config BL616CL_AVE_V10_I2C0
	bool "BL616CL-AVE-V10 I2C0 (ES8388, camera SCCB)"
	default n
	select BL616CL_I2C
	select BL616CL_I2C0
	---help---
		Register I2C0 as /dev/i2c0 on GPIO20 (SCL) and GPIO11 (SDA). The
		board wires the ES8388 codec (address 0x10) and the camera
		connector SCCB to this bus with 4.7 kOhm pull-ups to 3.3 V.

menuconfig BL616CL_AVE_V10_AUDIO
	bool "BL616CL-AVE-V10 ES8388 audio (/dev/audio/pcm0, pcm_in0)"
	default n
	depends on AUDIO_ES8388 && BL616CL_DMA0
	select BL616CL_AVE_V10_I2C0
	select BL616CL_I2S
	---help---
		Register the ES8388 codec (I2C0 address 0x10, I2S0 with MCLK on
		GPIO1, BCLK 4, FS 5, DI 6, DO 7) as /dev/audio/pcm0 for playback and
		/dev/audio/pcm_in0 for recording; use one at a time.

		The speaker amplifier takes ROUT1 and ROUT2 as a differential pair,
		the on-board microphone is on LIN2, and the speaker lines come back
		attenuated to LIN1 and RIN1. The ES8388 output and input channel
		options select the codec path; this menu shows what the current
		choice gives on this board. The board README lists every choice.

if BL616CL_AVE_V10_AUDIO

comment "Speaker: ES8388 output Line 2 drives it from ROUT2"
	depends on ES8388_OUTPUT_CHANNEL_LINE2

comment "Speaker: ES8388 output Line 1 drives it from ROUT1 (untested)"
	depends on ES8388_OUTPUT_CHANNEL_LINE1

comment "Speaker: nearly silent, output Both cancels at the amplifier"
	depends on ES8388_OUTPUT_CHANNEL_ALL

comment "Recording: ES8388 input Line 2 is the on-board microphone"
	depends on ES8388_INPUT_CHANNEL_LINE2

comment "Recording: ES8388 input Line 1 is the speaker feedback (untested)"
	depends on ES8388_INPUT_CHANNEL_LINE1

comment "Recording: input Differential is the speaker feedback (untested)"
	depends on ES8388_INPUT_CHANNEL_DIFFERENTIAL

endif # BL616CL_AVE_V10_AUDIO
```

## boards/bl616cl/bl616cldg/Kconfig
```kconfig
#
# For a description of the syntax of this configuration file,
# see the file kconfig-language.txt in the NuttX tools repository.
#

if ARCH_BOARD_CUSTOM

config BL616CLDG_BOARD_CONSOLE
	bool "Enable BL616CLDG board console hook"
	default n
	---help---
		Enable board-managed console hooks for BL616CLDG.  Keep this
		disabled for baseline bring-up because early output and console
		registration are owned by the chip serial driver.

config BL616CLDG_BOARD_DIAGNOSTICS
	bool "Enable BL616CLDG board diagnostics"
	default n
	---help---
		Enable board diagnostics hooks for BL616CLDG.  Keep this disabled
		for baseline bring-up because SDK banner, version, flash-info and
		anti-rollback paths are not kernel start requirements.

config BL616CLDG_BOARD_IRQS
	bool "Enable BL616CLDG board IRQ hooks"
	default n
	---help---
		Enable board-managed IRQ hooks for BL616CLDG.  Keep this disabled
		for baseline bring-up because the chip layer owns CLIC setup and
		wireless IRQs must be attached by their own drivers.

config BL616CLDG_PSRAM_HEAP
	bool "Enable BL616CLDG PSRAM heap"
	default n
	---help---
		Enable BL616CLDG PSRAM heap registration.  Keep this disabled for
		baseline bring-up because PSRAM must be initialized and owned
		explicitly before it can be exposed to the NuttX heap.

config BL616CLDG_PERIPHERAL_CLOCKS
	bool "Enable BL616CLDG board peripheral clocks"
	default n
	---help---
		Enable board-managed peripheral clock setup.  Keep this disabled
		for baseline bring-up because each NuttX driver should own its
		clock source and gate when it is registered.

config BL616CLDG_PM_RECOVERY
	bool "Enable BL616CLDG PM recovery"
	default n
	---help---
		Enable BL616CLDG low-power recovery registration.  Keep this
		disabled for baseline bring-up because PSRAM, clock and UART
		restore ordering must be designed against the openvela PM model.

config BL616CLDG_BOARD_TIME
	bool "Enable BL616CLDG board time hook"
	default n
	---help---
		Enable BL616CLDG board time hooks.  Keep this disabled for
		baseline bring-up because RTC ownership must be routed through
		the openvela RTC driver model, not the SDK device framework.

endif
```
